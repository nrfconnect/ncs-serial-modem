## CMakeLists.txt
```
#
# Copyright (c) 2026 Nordic Semiconductor ASA
#
# SPDX-License-Identifier: LicenseRef-Nordic-5-Clause
#

cmake_minimum_required(VERSION 3.20.0)

find_package(Zephyr REQUIRED HINTS $ENV{ZEPHYR_BASE})
project(at_mqtt_test)

# Generate sm_version.h header
set(GENERATED_DIR "${PROJECT_BINARY_DIR}/generated")
file(MAKE_DIRECTORY "${GENERATED_DIR}")
add_custom_target(
    generate_version_header ALL
    COMMAND ${CMAKE_COMMAND}
            -DOUTPUT_FILE=${GENERATED_DIR}/sm_version.h
            -DVERSION_FILE=${CMAKE_CURRENT_SOURCE_DIR}/VERSION
            -P ${CMAKE_CURRENT_SOURCE_DIR}/../../cmake/write_sm_version_header.cmake
    BYPRODUCTS ${GENERATED_DIR}/sm_version.h
    WORKING_DIRECTORY ${CMAKE_CURRENT_SOURCE_DIR}/../..
    COMMENT "Regenerating sm_version.h"
)
zephyr_include_directories("${GENERATED_DIR}")

# Compiler options to set configuration values
target_compile_options(app PRIVATE
  -D__ELASTERROR=2000
  # Suppress upstream Zephyr warnings in net_if.h (returns address of local var)
  -Wno-return-local-addr
)

if(CONFIG_SM_TEST_MQTT_VERSION_5_0)
  zephyr_compile_definitions(CONFIG_MQTT_VERSION_5_0=1)
endif()

# Generate CMock mocks for external dependencies
cmock_handle(${ZEPHYR_BASE}/../nrfxlib/nrf_modem/include/nrf_modem.h)
cmock_handle(${ZEPHYR_NRF_MODULE_DIR}/include/modem/nrf_modem_lib.h)
cmock_handle(${ZEPHYR_BASE}/../nrfxlib/nrf_modem/include/nrf_socket.h)
cmock_handle(${ZEPHYR_BASE}/../nrfxlib/nrf_modem/include/nrf_modem_at.h
  FUNC_EXCLUDE "__nrf_modem_printf_like"
  FUNC_EXCLUDE "__nrf_modem_scanf_like"
  FUNC_EXCLUDE "nrf_modem_at_cmd")
cmock_handle(${ZEPHYR_BASE}/include/zephyr/net/socket.h zephyr/net)
# Mock the MQTT library. mqtt_client_init() is called from a SYS_INIT hook
# (sm_at_mqtt_init) before CMock is initialised, so exclude it and provide a
# manual no-op stub in src/mqtt_stubs.c instead.
cmock_handle(${ZEPHYR_BASE}/include/zephyr/net/mqtt.h zephyr/net
  FUNC_EXCLUDE "mqtt_client_init")

# Generate test runner
test_runner_generate(src/test_at_mqtt.c)

# Add sources
target_sources(app PRIVATE
  src/test_at_mqtt.c
  src/nrf_modem_at_wrapper.c
  src/mqtt_stubs.c
  ../stubs/uart_stubs.c
  ../stubs/sm_at_host_stubs.c
  ../stubs/control_pin_stubs.c
  ../stubs/pm_stubs.c
  ../stubs/tfm_stubs.c
  ../stubs/at_cmd_custom_stubs.c
  ../stubs/sm_workq.c
  ../stubs/sm_log_stubs.c
  ../../src/sm_util.c
  ../../src/sm_at_mqtt.c
  ../../src/sm_at_host.c
  ../../src/sm_at_commands.c
  ${ZEPHYR_BASE}/subsys/modem/modem_pipe.c
)

# Include directories - override headers first. Reuse the at_socket test's
# stub/override headers (pm_config.h, fw_info.h, hal/, modem/, tfm/).
set(includes
  "${PROJECT_SOURCE_DIR}/../at_socket/include"
  "${PROJECT_SOURCE_DIR}/../../src"
  "${ZEPHYR_BASE}/../nrfxlib/nrf_modem/include"
  "${ZEPHYR_BASE}/include"
  "${ZEPHYR_BASE}/lib/libc/common/include"
  "${PROJECT_SOURCE_DIR}/../stubs"
)

target_include_directories(app PRIVATE ${includes})
```

## Kconfig
```
# Copyright (c) 2026 Nordic Semiconductor ASA
# SPDX-License-Identifier: LicenseRef-Nordic-5-Clause

# Symbols used by sm_at_mqtt.c that are normally gated behind SM_MQTTC
# (which selects MQTT_LIB and thus the full socket stack). Defined here
# without parent constraints so the test build can set them while keeping
# the MQTT library mocked.

config SM_MQTTC_MESSAGE_BUFFER_LEN
	int "Size of the MQTT RX/TX buffers"
	default 512
	range 1 65536

config MQTT_KEEPALIVE
	int "MQTT keep-alive interval (seconds)"
	default 60

config MQTT_CLEAN_SESSION
	bool "MQTT clean session"
	default n

# MQTT 5.0 symbols used by zephyr/net/mqtt.h. MQTT_VERSION_5_0 is a member of
# a choice in the MQTT library Kconfig and cannot be redefined here, so this
# test symbol makes CMakeLists.txt define CONFIG_MQTT_VERSION_5_0 instead.
config SM_TEST_MQTT_VERSION_5_0
	bool "Build the test with MQTT 5.0 library support"

if SM_TEST_MQTT_VERSION_5_0

config MQTT_USER_PROPERTIES_MAX
	int "Maximum number of user properties in a packet"
	default 1

config MQTT_SUBSCRIPTION_ID_PROPERTIES_MAX
	int "Maximum number of Subscription ID properties in a PUBLISH packet"
	default 1

config MQTT_TOPIC_ALIAS_MAX
	int "Maximum number of supported topic aliases"
	default 5

config MQTT_TOPIC_ALIAS_STRING_MAX
	int "Maximum length of a topic alias name"
	default 64

config SM_MQTTC_TOPIC_ALIAS_MAX
	int "Maximum number of outgoing MQTT 5.0 topic aliases"
	default 2
	help
	  Test-only value; the application default in app/Kconfig is 4.
	  A small table lets the tests fill it with few topics.

endif # SM_TEST_MQTT_VERSION_5_0

# SM core symbols — normally defined inside menu "Nordic Serial Modem" in
# app/Kconfig.  Redefined here as standalone symbols because the app Kconfig
# cannot be rsourced (it owns mainmenu and sources Kconfig.zephyr itself).

# NRF_MODEM_LIB_MEM_DIAG is normally gated by NRF_MODEM_LIB; define it here
# so the nrf_modem_lib_diag_stats mock compiles with the full struct definition.
config NRF_MODEM_LIB_MEM_DIAG
	bool "modem lib diagnostics"

config SM_CUSTOMER_VERSION
	string "Customer version string"

config SM_URC_BUFFER_SIZE
	int "URC TX buffer size"
	default 4096

config SM_DATAMODE_BUF_SIZE
	int "Data mode buffer size"
	range 1024 8192
	default 4096

config SM_DATAMODE_TERMINATOR
	string "Data mode terminator pattern"
	default "+++"

# Integer log level: 0=off 1=err 2=wrn 3=inf 4=dbg (Zephyr log_config template)
config SM_LOG_LEVEL
	int "Log level"
	default 3

config SM_CR_LF_TERMINATION
	bool "CR+LF termination"

config SM_URC_DELAY_WITH_INCOMPLETE_ECHO_MS
	int "URC delay with incomplete echo (ms)"
	default 1000

config SM_AT_ECHO_MAX_LEN
	int "Maximum AT command echo length"
	range 2 4096
	default 4096

config SM_UART_RX_BUF_SIZE
	int "UART RX buffer size"
	range 128 4096
	default 256

config SM_UART_TX_BUF_SIZE
	int "UART TX buffer size"
	range 128 4096
	default 256

config SM_CMUX_CHANNEL_COUNT
	int "CMUX channel count"
	default 1

# subsys/net/ip/Kconfig is not sourced when the network stack is disabled,
# so define this symbol explicitly to get the AF_INET/SOCK_STREAM etc. aliases.
config NET_NAMESPACE_COMPAT_MODE
	bool "Network namespace compatibility mode"
	default y

source "Kconfig.zephyr"
```

## prj.conf
```kconfig
#
# Copyright (c) 2026 Nordic Semiconductor ASA
#
# SPDX-License-Identifier: LicenseRef-Nordic-5-Clause
#

CONFIG_UNITY=y
CONFIG_ASSERT=n

CONFIG_ASAN=y

CONFIG_DEBUG=y
CONFIG_NO_OPTIMIZATIONS=y

CONFIG_AT_PARSER=y
CONFIG_RING_BUFFER=y
CONFIG_REBOOT=y
CONFIG_EVENTS=y
CONFIG_HEAP_MEM_POOL_SIZE=16384

# Logging
CONFIG_LOG=y
CONFIG_LOG_MODE_IMMEDIATE=y
CONFIG_LOG_PRINTK=y
CONFIG_LOG_BACKEND_SHOW_COLOR=n
CONFIG_LOG_BACKEND_FORMAT_TIMESTAMP=n

# Native sim settings
CONFIG_NATIVE_SIM_SLOWDOWN_TO_REAL_TIME=n

# SM core settings (see Kconfig)
CONFIG_NRF_MODEM_LIB_MEM_DIAG=y
CONFIG_SM_CR_LF_TERMINATION=y
CONFIG_SM_AT_ECHO_MAX_LEN=256

# MQTT client settings (see Kconfig)
CONFIG_MQTT_CLEAN_SESSION=y
CONFIG_SM_TEST_MQTT_VERSION_5_0=y
```

## src/mqtt_stubs.c
```c
/*
 * Copyright (c) 2026 Nordic Semiconductor ASA
 *
 * SPDX-License-Identifier: LicenseRef-Nordic-5-Clause
 */

/**
 * @file mqtt_stubs.c
 * Manual stubs for MQTT library functions that must not be mocked.
 *
 * mqtt_client_init() is invoked from the sm_at_mqtt_init() SYS_INIT hook, which
 * runs before CMock is initialised in setUp(). Calling a CMock mock at that
 * point would fail, so it is excluded from mocking (see CMakeLists.txt) and
 * stubbed here as a no-op.
 */

#include <zephyr/kernel.h>
#include <zephyr/net/mqtt.h>

void mqtt_client_init(struct mqtt_client *client)
{
	ARG_UNUSED(client);
}

/* sm_at_host.c wires these socket poll-work handlers into every AT host ctx.
 * They live in sm_at_socket.c, which this test does not compile, so stub them.
 */
void sm_at_socket_poll_work_handler(struct k_work *work)
{
	ARG_UNUSED(work);
}

void sm_at_socket_poll_idle_handler(struct k_work *work)
{
	ARG_UNUSED(work);
}
```

## src/nrf_modem_at_wrapper.c
```c
/*
 * Copyright (c) 2026 Nordic Semiconductor ASA
 *
 * SPDX-License-Identifier: LicenseRef-Nordic-5-Clause
 */

/**
 * @file nrf_modem_at_wrapper.c
 * Wrapper for nrf_modem_at_cmd that routes Serial Modem custom AT#XMQTT*
 * commands to their generated handler wrappers in tests.
 */

#include <string.h>
#include <strings.h>
#include <stdarg.h>
#include <errno.h>
#include <stdio.h>
#include <nrf_modem_at.h>
#include <modem/at_cmd_custom.h>

/* CMock-generated internal function for handling mock expectations.
 * Not in header because CMock doesn't generate declarations for variadic functions.
 */
extern int __cmock_nrf_modem_at_cmd(void *buf, size_t len, const char *fmt, ...);

/* Custom command wrapper functions generated by the SM_AT_CMD_CUSTOM macro. */
extern int handle_at_mqtt_config_wrapper_xmqttcfg(char *buf, size_t len, char *at_cmd);
extern int handle_at_mqtt_connect_wrapper_xmqttcon(char *buf, size_t len, char *at_cmd);
extern int handle_at_mqtt_publish_wrapper_xmqttpub(char *buf, size_t len, char *at_cmd);
extern int handle_at_mqtt_publish_empty_wrapper_xmqttpubempty(char *buf, size_t len, char *at_cmd);
extern int handle_at_mqtt_subscribe_wrapper_xmqttsub(char *buf, size_t len, char *at_cmd);
extern int handle_at_mqtt_unsubscribe_wrapper_xmqttunsub(char *buf, size_t len, char *at_cmd);

/* Wrapper for nrf_modem_at_cmd that handles custom commands */
int nrf_modem_at_cmd(void *buf, size_t buf_size, const char *fmt, ...)
{
	va_list args;
	char at_cmd[256];
	int ret;

	va_start(args, fmt);
	ret = vsnprintf(at_cmd, sizeof(at_cmd), fmt, args);
	va_end(args);

	if (ret < 0 || ret >= (int)sizeof(at_cmd)) {
		return -EINVAL;
	}

	/* Route Serial Modem custom commands (AT#...). Check the longer
	 * command prefixes before the shorter ones to avoid false matches.
	 */
	if (strncasecmp(at_cmd, "AT#", 3) == 0) {
		if (strncasecmp(at_cmd, "AT#XMQTTPUBEMPTY", sizeof("AT#XMQTTPUBEMPTY") - 1) == 0) {
			ret = handle_at_mqtt_publish_empty_wrapper_xmqttpubempty((char *)buf,
										 buf_size, at_cmd);
		} else if (strncasecmp(at_cmd, "AT#XMQTTUNSUB", 13) == 0) {
			ret = handle_at_mqtt_unsubscribe_wrapper_xmqttunsub((char *)buf, buf_size,
									    at_cmd);
		} else if (strncasecmp(at_cmd, "AT#XMQTTCFG", 11) == 0) {
			ret = handle_at_mqtt_config_wrapper_xmqttcfg((char *)buf, buf_size, at_cmd);
		} else if (strncasecmp(at_cmd, "AT#XMQTTCON", 11) == 0) {
			ret = handle_at_mqtt_connect_wrapper_xmqttcon((char *)buf, buf_size,
								      at_cmd);
		} else if (strncasecmp(at_cmd, "AT#XMQTTPUB", 11) == 0) {
			ret = handle_at_mqtt_publish_wrapper_xmqttpub((char *)buf, buf_size,
								      at_cmd);
		} else if (strncasecmp(at_cmd, "AT#XMQTTSUB", 11) == 0) {
			ret = handle_at_mqtt_subscribe_wrapper_xmqttsub((char *)buf, buf_size,
									at_cmd);
		} else {
			/* Unknown custom command - return error */
			return -EINVAL;
		}

		return ret;
	}

	/* Not a custom command - delegate to CMock */
	return __cmock_nrf_modem_at_cmd(buf, buf_size, "%s", at_cmd);
}
```
