## CMakeLists.txt
```
#
# Copyright (c) 2026 Nordic Semiconductor ASA
#
# SPDX-License-Identifier: LicenseRef-Nordic-5-Clause
#

cmake_minimum_required(VERSION 3.20.0)

find_package(Zephyr REQUIRED HINTS $ENV{ZEPHYR_BASE})
project(at_ppp_test)

zephyr_include_directories(${ZEPHYR_NRFXLIB_MODULE_DIR}/nrf_modem/include/)

# Compiler options to set configuration values
target_compile_options(app PRIVATE
  -D__ELASTERROR=2000
  # Suppress upstream Zephyr warnings in net_if.h (returns address of local var)
  -Wno-return-local-addr
)

# Generate test runner
test_runner_generate(src/test_at_ppp.c)

# Add sources.
#
# Only sm_ppp.c and sm_cmux.c are compiled from the application; everything
# they depend on is stubbed so that the PPP state machine can be driven
# deterministically.
target_sources(app PRIVATE
  src/test_at_ppp.c
  src/net_if_stubs.c
  src/socket_stubs.c
  src/cmux_stubs.c
  src/sm_stubs.c
  ../stubs/sm_workq.c
  ../stubs/at_cmd_custom_stubs.c
  ../../src/sm_ppp.c
  ../../src/sm_cmux.c
  ../../src/sm_at_urc_filter.c
)

# Include directories - test-specific overrides first so that they shadow the
# real <zephyr/modem/ppp.h>, <zephyr/modem/cmux.h>,
# <zephyr/posix/sys/eventfd.h> and <modem/at_cmd_custom.h> headers.
set(includes
  "${PROJECT_SOURCE_DIR}/include"
  "${PROJECT_SOURCE_DIR}/../at_commands/include"
  "${PROJECT_SOURCE_DIR}/src"
  "${PROJECT_SOURCE_DIR}/../../src"
  "${ZEPHYR_BASE}/../nrfxlib/nrf_modem/include"
  "${ZEPHYR_BASE}/include"
  "${ZEPHYR_BASE}/lib/libc/common/include"
  "${PROJECT_SOURCE_DIR}/../stubs"
)

target_include_directories(app PRIVATE ${includes})
```

## Kconfig
```
#
# Copyright (c) 2026 Nordic Semiconductor ASA
#
# SPDX-License-Identifier: LicenseRef-Nordic-5-Clause
#

# SM core and PPP/CMUX symbols — normally defined inside menu "Nordic Serial Modem"
# in app/Kconfig. Redefined here as standalone symbols because the app Kconfig
# cannot be re-sourced (it owns mainmenu and sources Kconfig.zephyr itself).

# Integer log level: 0=off 1=err 2=wrn 3=inf 4=dbg (Zephyr log_config template)
config SM_LOG_LEVEL
	int "Log level"
	default 3

config SM_PPP
	bool "PPP support"

config SM_PPP_FALLBACK_MTU
	int "Fallback MTU to be used by PPP"
	default 1280

config SM_CMUX
	bool "CMUX support"

config SM_CMUX_CHANNEL_COUNT
	int "CMUX channel count"
	default 1

# subsys/net/ip/Kconfig is not sourced when the network stack is disabled,
# so define this symbol explicitly to get the AF_PACKET/SOL_SOCKET etc. aliases.
config NET_NAMESPACE_COMPAT_MODE
	bool "Network namespace compatibility mode"
	default y

source "Kconfig.zephyr"
```

## prj.conf
```kconfig
#
# Copyright (c) 2026 Nordic Semiconductor ASA
#
# SPDX-License-Identifier: LicenseRef-Nordic-5-Clause
#

CONFIG_UNITY=y
CONFIG_ASSERT=n

CONFIG_ASAN=y

CONFIG_DEBUG=y
CONFIG_NO_OPTIMIZATIONS=y

CONFIG_AT_PARSER=y
CONFIG_AT_MONITOR=y
CONFIG_AT_MONITOR_HEAP_SIZE=1024

CONFIG_RING_BUFFER=y
CONFIG_EVENTS=y
CONFIG_HEAP_MEM_POOL_SIZE=16384

CONFIG_TEST_RANDOM_GENERATOR=y

# Logging
CONFIG_LOG=y
CONFIG_LOG_MODE_IMMEDIATE=y
CONFIG_LOG_PRINTK=y
CONFIG_LOG_BACKEND_SHOW_COLOR=n
CONFIG_LOG_BACKEND_FORMAT_TIMESTAMP=n

# Native sim settings
CONFIG_NATIVE_SIM_SLOWDOWN_TO_REAL_TIME=n

# SM core and PPP/CMUX settings (see Kconfig)
CONFIG_SM_LOG_LEVEL=0
CONFIG_SM_PPP=y
CONFIG_SM_PPP_FALLBACK_MTU=1500
CONFIG_SM_CMUX=y
CONFIG_SM_CMUX_CHANNEL_COUNT=3
```

## src/cmux_stubs.c
```c
/*
 * Copyright (c) 2026 Nordic Semiconductor ASA
 *
 * SPDX-License-Identifier: LicenseRef-Nordic-5-Clause
 */

/**
 * @file cmux_stubs.c
 *
 * CMUX multiplexer and UART backend stubs used by the sm_cmux.c/sm_ppp.c unit
 * tests.
 *
 * The real Zephyr CMUX subsystem is replaced by a bookkeeping-only
 * implementation: modem_cmux_dlci_init() hands out one distinct fake pipe per
 * DLCI address so that the tests can assert exactly which channel each
 * consumer (AT host, PPP, trace backend) ends up with.
 */

#include <errno.h>
#include <string.h>
#include <zephyr/kernel.h>
#include <zephyr/modem/cmux.h>

#include "ppp_stubs.h"

/* Fake pipes. Only their addresses are ever used. */
static struct modem_pipe *const uart_pipe = (struct modem_pipe *)0x1000;
static struct modem_pipe *const dlci_pipes[PPP_STUB_MAX_DLCI] = {
	(struct modem_pipe *)0x2001,
	(struct modem_pipe *)0x2002,
	(struct modem_pipe *)0x2003,
	(struct modem_pipe *)0x2004,
};

static struct modem_cmux *attached_cmux;

int ppp_stub_cmux_attach_ret;
unsigned int ppp_stub_cmux_attach_calls;
unsigned int ppp_stub_cmux_release_calls;

struct modem_pipe *ppp_stub_uart_pipe(void)
{
	return uart_pipe;
}

struct modem_pipe *ppp_stub_dlci_pipe(uint8_t address)
{
	if (address < 1 || address > PPP_STUB_MAX_DLCI) {
		return NULL;
	}
	return dlci_pipes[address - 1];
}

const char *ppp_stub_pipe_name(struct modem_pipe *pipe)
{
	if (pipe == NULL) {
		return "none";
	}
	if (pipe == uart_pipe) {
		return "uart";
	}
	for (uint8_t i = 0; i < PPP_STUB_MAX_DLCI; i++) {
		if (pipe == dlci_pipes[i]) {
			static char name[8];

			(void)snprintk(name, sizeof(name), "dlci%u", i + 1);
			return name;
		}
	}
	return "unknown";
}

void ppp_stub_cmux_reset(void)
{
	attached_cmux = NULL;
	ppp_stub_cmux_attach_ret = 0;
	ppp_stub_cmux_attach_calls = 0;
	ppp_stub_cmux_release_calls = 0;
}

void ppp_stub_cmux_signal_disconnect(void)
{
	if (attached_cmux && attached_cmux->callback) {
		attached_cmux->callback(attached_cmux, MODEM_CMUX_EVENT_DISCONNECTED,
					attached_cmux->user_data);
	}
}

/* --- Zephyr modem CMUX API --------------------------------------------- */

void modem_cmux_init(struct modem_cmux *cmux, const struct modem_cmux_config *config)
{
	memset(cmux, 0, sizeof(*cmux));
	cmux->callback = config->callback;
	cmux->user_data = config->user_data;
}

struct modem_pipe *modem_cmux_dlci_init(struct modem_cmux *cmux, struct modem_cmux_dlci *dlci,
					const struct modem_cmux_dlci_config *config)
{
	dlci->cmux = cmux;
	dlci->dlci_address = config->dlci_address;

	return ppp_stub_dlci_pipe(config->dlci_address);
}

int modem_cmux_attach(struct modem_cmux *cmux, struct modem_pipe *pipe)
{
	ppp_stub_cmux_attach_calls++;

	if (ppp_stub_cmux_attach_ret) {
		return ppp_stub_cmux_attach_ret;
	}

	cmux->pipe = pipe;
	cmux->attached = true;
	attached_cmux = cmux;

	return 0;
}

void modem_cmux_release(struct modem_cmux *cmux)
{
	ppp_stub_cmux_release_calls++;
	cmux->pipe = NULL;
	cmux->attached = false;
	attached_cmux = NULL;
}

/* --- Serial Modem UART backend ------------------------------------------ */

struct modem_pipe *sm_uart_pipe_get(void)
{
	return uart_pipe;
}

/* --- Modem trace backend ------------------------------------------------ */

void sm_trace_backend_attach(struct modem_pipe *pipe)
{
	ARG_UNUSED(pipe);
}

void sm_trace_backend_detach(void)
{
}
```

## src/net_if_stubs.c
```c
/*
 * Copyright (c) 2026 Nordic Semiconductor ASA
 *
 * SPDX-License-Identifier: LicenseRef-Nordic-5-Clause
 */

/**
 * @file net_if_stubs.c
 *
 * Fake PPP network interface used by the sm_ppp.c unit tests.
 *
 * The real Zephyr <zephyr/net/net_if.h> header is used, so all the inline
 * accessors (net_if_l2_data(), net_if_flag_set(), net_if_set_mtu(), ...)
 * operate on the fake interface defined here. The out-of-line net_if API that
 * sm_ppp.c relies on is implemented below with failure injection support.
 */

#include <string.h>
#include <zephyr/kernel.h>
#include <zephyr/net/net_if.h>
#include <zephyr/net/net_mgmt.h>
#include <zephyr/net/ppp.h>
#include <zephyr/modem/ppp.h>

#include "ppp_stubs.h"

static struct ppp_context stub_ppp_ctx;
static struct net_if_dev stub_if_dev = {
	.l2_data = &stub_ppp_ctx,
	.mtu = 1500,
};
static struct net_if stub_iface = {
	.if_dev = &stub_if_dev,
};

int ppp_stub_net_if_up_ret;
int ppp_stub_net_if_down_ret;
int ppp_stub_net_if_down_fail_count;

unsigned int ppp_stub_net_if_up_calls;
unsigned int ppp_stub_net_if_down_calls;
unsigned int ppp_stub_net_if_carrier_on_calls;
unsigned int ppp_stub_net_if_carrier_off_calls;
unsigned int ppp_stub_net_if_dormant_on_calls;
unsigned int ppp_stub_net_if_dormant_off_calls;
uint16_t ppp_stub_net_if_mtu;

/* Registered by sm_ppp.c with NET_MGMT_REGISTER_EVENT_HANDLER(). The net_mgmt
 * event subsystem is not part of this build, so the iterable section it would
 * normally be collected into does not exist and the handler is referenced by
 * name instead.
 */
extern const struct net_mgmt_event_static_handler sm_ppp_event_handler;

void ppp_stub_raise_ppp_phase_event(uint64_t mgmt_event)
{
	if ((sm_ppp_event_handler.event_mask & mgmt_event) != mgmt_event) {
		return;
	}
	sm_ppp_event_handler.handler(mgmt_event, &stub_iface, NULL, 0,
				     sm_ppp_event_handler.user_data);
}

struct net_if *ppp_stub_iface(void)
{
	return &stub_iface;
}

void ppp_stub_net_if_reset(void)
{
	ppp_stub_net_if_up_ret = 0;
	ppp_stub_net_if_down_ret = 0;
	ppp_stub_net_if_down_fail_count = 0;
	ppp_stub_net_if_up_calls = 0;
	ppp_stub_net_if_down_calls = 0;
	ppp_stub_net_if_carrier_on_calls = 0;
	ppp_stub_net_if_carrier_off_calls = 0;
	ppp_stub_net_if_dormant_on_calls = 0;
	ppp_stub_net_if_dormant_off_calls = 0;
	ppp_stub_net_if_mtu = 0;
	memset(&stub_ppp_ctx, 0, sizeof(stub_ppp_ctx));
	atomic_clear_bit(stub_if_dev.flags, NET_IF_UP);
	atomic_clear_bit(stub_if_dev.flags, NET_IF_DORMANT);
	atomic_clear_bit(stub_if_dev.flags, NET_IF_LOWER_UP);
}

/* --- Out-of-line net_if API -------------------------------------------- */

int net_if_up(struct net_if *iface)
{
	ppp_stub_net_if_up_calls++;

	if (ppp_stub_net_if_up_ret) {
		return ppp_stub_net_if_up_ret;
	}

	atomic_set_bit(iface->if_dev->flags, NET_IF_UP);
	ppp_stub_net_if_mtu = iface->if_dev->mtu;
	return 0;
}

int net_if_down(struct net_if *iface)
{
	ppp_stub_net_if_down_calls++;

	if (ppp_stub_net_if_down_fail_count > 0) {
		ppp_stub_net_if_down_fail_count--;
		return ppp_stub_net_if_down_ret ? ppp_stub_net_if_down_ret : -EIO;
	}

	atomic_clear_bit(iface->if_dev->flags, NET_IF_UP);
	return 0;
}

void net_if_carrier_on(struct net_if *iface)
{
	ppp_stub_net_if_carrier_on_calls++;
	atomic_set_bit(iface->if_dev->flags, NET_IF_LOWER_UP);
}

void net_if_carrier_off(struct net_if *iface)
{
	ppp_stub_net_if_carrier_off_calls++;
	atomic_clear_bit(iface->if_dev->flags, NET_IF_LOWER_UP);
}

void net_if_dormant_on(struct net_if *iface)
{
	ppp_stub_net_if_dormant_on_calls++;
	atomic_set_bit(iface->if_dev->flags, NET_IF_DORMANT);
}

void net_if_dormant_off(struct net_if *iface)
{
	ppp_stub_net_if_dormant_off_calls++;
	atomic_clear_bit(iface->if_dev->flags, NET_IF_DORMANT);
}

int net_if_get_by_iface(struct net_if *iface)
{
	return (iface == &stub_iface) ? 1 : -1;
}

int net_if_set_link_addr_locked(struct net_if *iface, const uint8_t *addr, uint8_t len,
				enum net_link_type type)
{
	if (iface == NULL || addr == NULL || len > sizeof(iface->if_dev->link_addr.addr)) {
		return -EINVAL;
	}

	memcpy(iface->if_dev->link_addr.addr, addr, len);
	iface->if_dev->link_addr.len = len;
	iface->if_dev->link_addr.type = type;
	return 0;
}

/* --- modem_ppp fake ----------------------------------------------------- */

int modem_ppp_attach(struct modem_ppp *ppp, struct modem_pipe *pipe)
{
	ppp->pipe = pipe;
	ppp->attached = true;
	return 0;
}

int modem_ppp_release(struct modem_ppp *ppp)
{
	ppp->pipe = NULL;
	ppp->attached = false;
	return 0;
}

struct net_if *modem_ppp_get_iface(struct modem_ppp *ppp)
{
	ARG_UNUSED(ppp);
	return &stub_iface;
}
```

## src/ppp_stubs.h
```c
/*
 * Copyright (c) 2026 Nordic Semiconductor ASA
 *
 * SPDX-License-Identifier: LicenseRef-Nordic-5-Clause
 */

/**
 * @file ppp_stubs.h
 *
 * Control and observation interface of the stubs used by the sm_ppp.c unit
 * tests (net_if_stubs.c, socket_stubs.c and sm_stubs.c).
 */

#ifndef PPP_STUBS_H_
#define PPP_STUBS_H_

#include <stdbool.h>
#include <stddef.h>
#include <stdint.h>

struct net_if;
struct modem_pipe;

/** Number of fake CMUX DLCI pipes provided by cmux_stubs.c. */
#define PPP_STUB_MAX_DLCI 4

/* ------------------------------------------------------------------------
 * CMUX / UART backend stubs (cmux_stubs.c)
 * ------------------------------------------------------------------------
 */

/** Reset the CMUX stub state and failure injection. */
void ppp_stub_cmux_reset(void);

/** Fake UART pipe returned by sm_uart_pipe_get(). */
struct modem_pipe *ppp_stub_uart_pipe(void);

/** Fake pipe of CMUX DLCI @p address (1-based), or NULL if out of range. */
struct modem_pipe *ppp_stub_dlci_pipe(uint8_t address);

/** Human readable name of a fake pipe, for assertion messages. */
const char *ppp_stub_pipe_name(struct modem_pipe *pipe);

/** Simulate the CMUX peer tearing the multiplexer down. */
void ppp_stub_cmux_signal_disconnect(void);

/** Error code returned by modem_cmux_attach(). 0 = success. */
extern int ppp_stub_cmux_attach_ret;

extern unsigned int ppp_stub_cmux_attach_calls;
extern unsigned int ppp_stub_cmux_release_calls;

/* ------------------------------------------------------------------------
 * net_if stubs (net_if_stubs.c)
 * ------------------------------------------------------------------------
 */

/** Fake PPP network interface handed out by modem_ppp_get_iface(). */
struct net_if *ppp_stub_iface(void);

/** Reset all net_if stub state and failure injection. */
void ppp_stub_net_if_reset(void);

/** Error code returned by the next net_if_up() call. 0 = success. */
extern int ppp_stub_net_if_up_ret;
/** Error code returned by the next net_if_down() calls. 0 = success. */
extern int ppp_stub_net_if_down_ret;
/** Number of net_if_down() calls that fail before it starts succeeding. */
extern int ppp_stub_net_if_down_fail_count;

extern unsigned int ppp_stub_net_if_up_calls;
extern unsigned int ppp_stub_net_if_down_calls;
extern unsigned int ppp_stub_net_if_carrier_on_calls;
extern unsigned int ppp_stub_net_if_carrier_off_calls;
extern unsigned int ppp_stub_net_if_dormant_on_calls;
extern unsigned int ppp_stub_net_if_dormant_off_calls;
extern uint16_t ppp_stub_net_if_mtu;

/* ------------------------------------------------------------------------
 * socket / eventfd stubs (socket_stubs.c)
 * ------------------------------------------------------------------------
 */

/** Reset all socket stub state and failure injection. */
void ppp_stub_socket_reset(void);

/**
 * Fail the n:th zsock_socket() call after the reset.
 * 0 disables the injection, 1 fails the Zephyr socket, 2 the modem socket.
 */
extern unsigned int ppp_stub_socket_fail_nth;
/** Make zsock_bind() fail. */
extern bool ppp_stub_bind_fail;
/** Make zsock_setsockopt() fail. */
extern bool ppp_stub_setsockopt_fail;
/** Value returned by zsock_inet_pton(). 1 = success. */
extern int ppp_stub_inet_pton_ret;

extern unsigned int ppp_stub_socket_calls;
extern unsigned int ppp_stub_close_calls;

/** Number of sockets created by zsock_socket() that are still open. */
unsigned int ppp_stub_open_socket_count(void);

/**
 * Descriptor of the @p idx:th still open socket, or -1 if there is none.
 * Descriptors are handed out lowest-free-first, like a real socket layer, so
 * closing and immediately reopening the PPP sockets recycles the same numbers.
 */
int ppp_stub_open_socket_fd(unsigned int idx);

/**
 * Invoke the net_mgmt event handlers sm_ppp.c registered for the PPP phase
 * events, as the net_mgmt event thread would. Use NET_EVENT_PPP_PHASE_RUNNING
 * to mark the peer as connected and NET_EVENT_PPP_PHASE_DEAD to drop the link.
 */
void ppp_stub_raise_ppp_phase_event(uint64_t mgmt_event);

/**
 * Block zsock_poll() from returning until ppp_stub_release_poll() is called.
 * This lets a test gather several independent events into a single poll
 * result.
 */
void ppp_stub_hold_poll(void);
void ppp_stub_release_poll(void);

/** Largest number of descriptors a single zsock_poll() call reported events on. */
extern unsigned int ppp_stub_max_poll_events;

/** Simulate a POLLERR on the PPP data sockets (link went down). */
void ppp_stub_signal_socket_error(void);

/** Make the next zsock_poll() call fail, which triggers a PPP restart. */
void ppp_stub_signal_poll_failure(void);

/* ------------------------------------------------------------------------
 * Serial Modem stubs (sm_stubs.c)
 * ------------------------------------------------------------------------
 */

/** Reset the Serial Modem stubs, including the captured response buffer. */
void ppp_stub_sm_reset(void);

/** Captured rsp_send()/urc_send_to() output. */
const char *ppp_stub_get_output(void);
void ppp_stub_clear_output(void);

/**
 * Pipe returned by sm_at_host_get_current()/sm_at_host_get_current_pipe().
 * Passing NULL drops every AT host context, modelling "no pipe in AT mode".
 */
void ppp_stub_set_current_pipe(struct modem_pipe *pipe);

/** Pipe the AT host is currently serving commands on. */
struct modem_pipe *ppp_stub_at_pipe(void);

/** Whether @p pipe currently has an AT host context, i.e. is in AT mode. */
bool ppp_stub_pipe_in_at_mode(struct modem_pipe *pipe);

/** Return value of sm_util_pdn_id_get(). */
extern int ppp_stub_pdn_id;
/** Return value of sm_util_cfun_is_lte_enabled(). */
extern bool ppp_stub_lte_enabled;
/** Return value of sm_util_cereg_is_registered(). */
extern bool ppp_stub_registered;
/** Return value of sm_util_is_cid_active(). */
extern bool ppp_stub_cid_active;
/** Return value of sm_util_at_printf() and sm_util_at_cmd_no_intercept(). */
extern int ppp_stub_at_ret;
/** Return value of sm_util_pdn_dynamic_info_get(). 0 = success. */
extern int ppp_stub_pdn_info_ret;
/** IPv4 address reported by util_get_ip_addr(). Empty string = none. */
extern char ppp_stub_ipv4_addr[];
/** IPv6 address reported by util_get_ip_addr(). Empty string = none. */
extern char ppp_stub_ipv6_addr[];

extern unsigned int ppp_stub_host_release_calls;
extern unsigned int ppp_stub_host_attach_calls;
extern unsigned int ppp_stub_cmd_done_calls;

/** Send an AT command to the sm_ppp.c custom command handlers. */
int ppp_stub_send_at(const char *at_cmd);

/** Last AT response ("OK\r\n", "ERROR\r\n", ...) built by sm_at_cb_wrapper(). */
const char *ppp_stub_last_at_response(void);

#endif /* PPP_STUBS_H_ */
```

## src/sm_stubs.c
```c
/*
 * Copyright (c) 2026 Nordic Semiconductor ASA
 *
 * SPDX-License-Identifier: LicenseRef-Nordic-5-Clause
 */

/**
 * @file sm_stubs.c
 *
 * Serial Modem AT host and utility stubs used by the sm_ppp.c unit tests.
 *
 * Only sm_ppp.c is compiled into this test image, so everything it uses from
 * sm_at_host.c and sm_util.c is stubbed here. All responses and URCs are
 * captured into a single buffer that the tests inspect.
 */

#include <errno.h>
#include <stdarg.h>
#include <stdio.h>
#include <string.h>
#include <strings.h>
#include <zephyr/kernel.h>

#include "sm_at_host.h"
#include "sm_cmux.h"
#include "sm_util.h"
#include "ppp_stubs.h"

/* --- Captured output ---------------------------------------------------- */

static char output[2048];
static size_t output_len;
static char last_response[64];

/* --- AT host context model ----------------------------------------------
 *
 * sm_at_host.c keeps one context per pipe that is in AT command mode. A pipe
 * that has been handed over to another consumer (PPP, trace backend) has no
 * context, which is exactly what sm_cmux.c and sm_ppp.c rely on. The stub
 * models that with a small fixed pool.
 */

struct sm_at_host_ctx {
	struct modem_pipe *pipe;
	bool in_use;
};

static struct sm_at_host_ctx contexts[PPP_STUB_MAX_DLCI + 1];
static struct sm_at_host_ctx *current_ctx;

static struct sm_at_host_ctx *ctx_alloc(struct modem_pipe *pipe)
{
	ARRAY_FOR_EACH_PTR(contexts, ctx) {
		if (!ctx->in_use) {
			ctx->in_use = true;
			ctx->pipe = pipe;
			return ctx;
		}
	}
	return NULL;
}

static void ctx_free(struct sm_at_host_ctx *ctx)
{
	if (current_ctx == ctx) {
		current_ctx = NULL;
	}
	ctx->in_use = false;
	ctx->pipe = NULL;
}

int ppp_stub_pdn_id = 1;
bool ppp_stub_lte_enabled = true;
bool ppp_stub_registered = true;
bool ppp_stub_cid_active = true;
int ppp_stub_at_ret;
int ppp_stub_pdn_info_ret;
char ppp_stub_ipv4_addr[NET_INET_ADDRSTRLEN] = "192.0.2.1";
char ppp_stub_ipv6_addr[NET_INET6_ADDRSTRLEN];

unsigned int ppp_stub_host_release_calls;
unsigned int ppp_stub_host_attach_calls;
unsigned int ppp_stub_cmd_done_calls;

bool sm_init_failed;

static void capture(const char *fmt, va_list args)
{
	char buf[512];
	int len = vsnprintf(buf, sizeof(buf), fmt, args);

	if (len <= 0) {
		return;
	}
	if ((size_t)len >= sizeof(buf)) {
		len = sizeof(buf) - 1;
	}
	if (output_len + len >= sizeof(output)) {
		len = sizeof(output) - output_len - 1;
	}
	memcpy(output + output_len, buf, len);
	output_len += len;
	output[output_len] = '\0';
}

const char *ppp_stub_get_output(void)
{
	return output;
}

void ppp_stub_clear_output(void)
{
	memset(output, 0, sizeof(output));
	output_len = 0;
}

void ppp_stub_set_current_pipe(struct modem_pipe *pipe)
{
	if (!pipe) {
		/* No pipe is in AT command mode at all. */
		memset(contexts, 0, sizeof(contexts));
		current_ctx = NULL;
		return;
	}

	struct sm_at_host_ctx *ctx = sm_at_host_get_ctx_from(pipe);

	if (!ctx) {
		ctx = ctx_alloc(pipe);
	}
	current_ctx = ctx;
}

struct modem_pipe *ppp_stub_at_pipe(void)
{
	return current_ctx ? current_ctx->pipe : NULL;
}

bool ppp_stub_pipe_in_at_mode(struct modem_pipe *pipe)
{
	return sm_at_host_get_ctx_from(pipe) != NULL;
}

const char *ppp_stub_last_at_response(void)
{
	return last_response;
}

void ppp_stub_sm_reset(void)
{
	ppp_stub_clear_output();
	memset(last_response, 0, sizeof(last_response));
	ppp_stub_pdn_id = 1;
	ppp_stub_lte_enabled = true;
	ppp_stub_registered = true;
	ppp_stub_cid_active = true;
	ppp_stub_at_ret = 0;
	ppp_stub_pdn_info_ret = 0;
	strcpy(ppp_stub_ipv4_addr, "192.0.2.1");
	ppp_stub_ipv6_addr[0] = '\0';
	ppp_stub_host_release_calls = 0;
	ppp_stub_host_attach_calls = 0;
	ppp_stub_cmd_done_calls = 0;
	sm_init_failed = false;

	memset(contexts, 0, sizeof(contexts));
	current_ctx = NULL;
}

/* --- sm_at_host stubs --------------------------------------------------- */

void rsp_send(const char *fmt, ...)
{
	va_list args;

	va_start(args, fmt);
	capture(fmt, args);
	va_end(args);
}

void rsp_send_to(struct modem_pipe *pipe, const char *fmt, ...)
{
	va_list args;

	ARG_UNUSED(pipe);
	va_start(args, fmt);
	capture(fmt, args);
	va_end(args);
}

void urc_send_to(struct modem_pipe *pipe, const char *fmt, ...)
{
	va_list args;

	ARG_UNUSED(pipe);
	va_start(args, fmt);
	capture(fmt, args);
	va_end(args);
}

void urc_send(const char *fmt, ...)
{
	va_list args;

	va_start(args, fmt);
	capture(fmt, args);
	va_end(args);
}

void rsp_send_ok(void)
{
	rsp_send("\r\nOK\r\n");
}

void rsp_send_error(void)
{
	rsp_send("\r\nERROR\r\n");
}

void sm_at_host_cmd_done(struct sm_at_host_ctx *ctx)
{
	ARG_UNUSED(ctx);
	ppp_stub_cmd_done_calls++;
}

void sm_at_host_release(struct sm_at_host_ctx *ctx)
{
	ppp_stub_host_release_calls++;

	if (!ctx || !ctx->in_use) {
		return;
	}
	/* The pipe is handed over to another consumer and leaves AT mode. */
	ctx_free(ctx);
}

void sm_at_host_attach(struct modem_pipe *pipe)
{
	ppp_stub_host_attach_calls++;

	if (!pipe || sm_at_host_get_ctx_from(pipe)) {
		return;
	}
	/* The pipe returns to AT command mode with a fresh context. */
	(void)ctx_alloc(pipe);
}

int sm_at_host_set_pipe(struct sm_at_host_ctx *ctx, struct modem_pipe *pipe)
{
	if (!ctx || !ctx->in_use || !pipe) {
		return -EINVAL;
	}

	/* Any context already owning the target pipe is destroyed, mirroring
	 * sm_at_host_set_pipe().
	 */
	struct sm_at_host_ctx *old = sm_at_host_get_ctx_from(pipe);

	if (old && old != ctx) {
		ctx_free(old);
	}
	ctx->pipe = pipe;
	return 0;
}

struct modem_pipe *sm_at_host_get_pipe(struct sm_at_host_ctx *ctx)
{
	return (ctx && ctx->in_use) ? ctx->pipe : NULL;
}

struct sm_at_host_ctx *sm_at_host_get_ctx_from(struct modem_pipe *pipe)
{
	if (!pipe) {
		return NULL;
	}
	ARRAY_FOR_EACH_PTR(contexts, ctx) {
		if (ctx->in_use && ctx->pipe == pipe) {
			return ctx;
		}
	}
	return NULL;
}

struct sm_at_host_ctx *sm_at_host_get_current(void)
{
	return current_ctx ? current_ctx : sm_at_host_get_urc_ctx();
}

struct sm_at_host_ctx *sm_at_host_get_urc_ctx(void)
{
	if (sm_cmux_is_started()) {
		/* URCs go to the first CMUX channel that is in AT command mode. */
		for (uint8_t ch = 1; ch <= CONFIG_SM_CMUX_CHANNEL_COUNT; ch++) {
			struct sm_at_host_ctx *ctx = sm_at_host_get_ctx_from(sm_cmux_get_dlci(ch));

			if (ctx) {
				return ctx;
			}
		}
	}

	/* Fall back to the oldest context, which is the one created for the
	 * UART pipe at boot.
	 */
	ARRAY_FOR_EACH_PTR(contexts, ctx) {
		if (ctx->in_use) {
			return ctx;
		}
	}
	return NULL;
}

/* --- sm_util stubs ------------------------------------------------------ */

int sm_util_at_printf(const char *fmt, ...)
{
	ARG_UNUSED(fmt);
	return ppp_stub_at_ret;
}

int sm_util_at_cmd_no_intercept(char *buf, size_t len, const char *at_cmd)
{
	ARG_UNUSED(at_cmd);

	if (ppp_stub_at_ret == 0 && buf && len) {
		snprintf(buf, len, "OK\r\n");
	}
	return ppp_stub_at_ret;
}

int util_string_get(struct at_parser *parser, size_t index, char *value, size_t *len)
{
	const size_t size = *len;
	int ret = at_parser_string_get(parser, index, value, len);

	if (ret) {
		return ret;
	}
	if (*len < size) {
		value[*len] = '\0';
		return 0;
	}
	return -ENOMEM;
}

void util_get_ip_addr(int cid, char addr4[NET_INET_ADDRSTRLEN], char addr6[NET_INET6_ADDRSTRLEN])
{
	ARG_UNUSED(cid);

	strcpy(addr4, ppp_stub_ipv4_addr);
	strcpy(addr6, ppp_stub_ipv6_addr);
}

int sm_util_pdn_id_get(uint8_t cid)
{
	ARG_UNUSED(cid);
	return ppp_stub_pdn_id;
}

int sm_util_pdn_dynamic_info_get(uint8_t cid, struct sm_pdn_dynamic_info *pdn_info)
{
	ARG_UNUSED(cid);

	if (ppp_stub_pdn_info_ret) {
		return ppp_stub_pdn_info_ret;
	}

	pdn_info->ipv4_mtu = 1464;
	pdn_info->ipv6_mtu = 0;
	return 0;
}

bool sm_util_cfun_is_lte_enabled(void)
{
	return ppp_stub_lte_enabled;
}

bool sm_util_cereg_is_registered(void)
{
	return ppp_stub_registered;
}

bool sm_util_is_cid_active(uint8_t cid)
{
	ARG_UNUSED(cid);
	return ppp_stub_cid_active;
}

/* --- nrf_modem stubs ---------------------------------------------------- */

void modem_pipe_release(struct modem_pipe *pipe)
{
	ARG_UNUSED(pipe);
}

int nrf_modem_at_notif_handler_set(nrf_modem_at_notif_handler_t callback)
{
	ARG_UNUSED(callback);
	return 0;
}

/* --- AT command dispatch ------------------------------------------------ */

int sm_at_cb_wrapper(char *buf, size_t len, char *at_cmd, size_t filter_len, sm_at_callback *cb)
{
	struct at_parser parser;
	size_t valid_count = 0;
	enum at_parser_cmd_type type;
	int err;

	if (!strchr("=?,", at_cmd[filter_len])) {
		return -EINVAL;
	}

	err = at_parser_init(&parser, at_cmd);
	if (err) {
		return err;
	}

	err = at_parser_cmd_count_get(&parser, &valid_count);
	if (err) {
		return err;
	}

	err = at_parser_cmd_type_get(&parser, &type);
	if (err) {
		return err;
	}

	err = cb(type, &parser, valid_count);
	if (!err) {
		snprintf(buf, len, "OK\r\n");
	} else if (err > 0) {
		snprintf(buf, len, "ERROR\r\n");
	}

	return err;
}

/* Wrappers generated by SM_AT_CMD_CUSTOM() in sm_ppp.c. */
extern int handle_at_ppp_wrapper_xppp(char *buf, size_t len, char *at_cmd);
extern int handle_at_cgdata_wrapper_cgdata(char *buf, size_t len, char *at_cmd);
/* Interceptors registered with AT_CMD_CUSTOM() in sm_at_urc_filter.c. */
extern int sm_urcf_cgerep_callback(char *buf, size_t len, char *at_cmd);
extern int sm_urcf_xtime_callback(char *buf, size_t len, char *at_cmd);
extern int sm_urcf_cfun_callback(char *buf, size_t len, char *at_cmd);
/* Wrappers generated by SM_AT_CMD_CUSTOM() in sm_cmux.c. */
extern int handle_at_xcmux_wrapper_xcmux(char *buf, size_t len, char *at_cmd);
extern int handle_at_xcmuxcld_wrapper_xcmuxcld(char *buf, size_t len, char *at_cmd);
extern int handle_at_cmux_wrapper_atcmux(char *buf, size_t len, char *at_cmd);

struct at_dispatch_entry {
	const char *prefix;
	int (*handler)(char *buf, size_t len, char *at_cmd);
};

/* Longest prefix first: "AT#XCMUXCLD" must win over "AT#XCMUX". */
static const struct at_dispatch_entry at_dispatch_table[] = {
	{"AT#XCMUXCLD", handle_at_xcmuxcld_wrapper_xcmuxcld},
	{"AT#XCMUX", handle_at_xcmux_wrapper_xcmux},
	{"AT#XPPP", handle_at_ppp_wrapper_xppp},
	{"AT+CMUX", handle_at_cmux_wrapper_atcmux},
	{"AT+CGDATA", handle_at_cgdata_wrapper_cgdata},
	{"AT+CGEREP", sm_urcf_cgerep_callback},
	{"AT%XTIME", sm_urcf_xtime_callback},
	{"AT+CFUN=", sm_urcf_cfun_callback},
};

int ppp_stub_send_at(const char *at_cmd)
{
	char cmd[128];

	strncpy(cmd, at_cmd, sizeof(cmd) - 1);
	cmd[sizeof(cmd) - 1] = '\0';
	memset(last_response, 0, sizeof(last_response));

	ARRAY_FOR_EACH_PTR(at_dispatch_table, entry) {
		if (strncasecmp(cmd, entry->prefix, strlen(entry->prefix)) == 0) {
			return entry->handler(last_response, sizeof(last_response), cmd);
		}
	}

	return -ENOTSUP;
}
```

## src/socket_stubs.c
```c
/*
 * Copyright (c) 2026 Nordic Semiconductor ASA
 *
 * SPDX-License-Identifier: LicenseRef-Nordic-5-Clause
 */

/**
 * @file socket_stubs.c
 *
 * Socket and eventfd stubs used by the sm_ppp.c unit tests.
 *
 * The real Zephyr socket headers are used, so only the syscall implementations
 * (z_impl_zsock_*) and zvfs_poll() need to be provided. No real traffic is
 * passed: zvfs_poll() blocks on a condition variable that is signalled either
 * by eventfd_write() (a PPP start/stop/restart event) or by
 * ppp_stub_signal_socket_error() (simulated link failure).
 */

#include <errno.h>
#include <string.h>
#include <zephyr/kernel.h>
#include <zephyr/net/socket.h>
#include <zephyr/posix/sys/eventfd.h>

#include "ppp_stubs.h"

#define STUB_EVENTFD        100
#define STUB_SOCKET_FD_BASE 200
#define STUB_MAX_SOCKETS    8

unsigned int ppp_stub_socket_fail_nth;
bool ppp_stub_bind_fail;
bool ppp_stub_setsockopt_fail;
int ppp_stub_inet_pton_ret = 1;
unsigned int ppp_stub_socket_calls;
unsigned int ppp_stub_close_calls;

static K_MUTEX_DEFINE(stub_lock);
static K_CONDVAR_DEFINE(stub_cond);

static uint64_t evfd_count;
static bool evfd_created;
static bool sock_err_pending;
static bool poll_fail_pending;
static bool poll_held;
static bool sock_open[STUB_MAX_SOCKETS];

unsigned int ppp_stub_max_poll_events;

void ppp_stub_socket_reset(void)
{
	k_mutex_lock(&stub_lock, K_FOREVER);
	ppp_stub_socket_fail_nth = 0;
	ppp_stub_bind_fail = false;
	ppp_stub_setsockopt_fail = false;
	ppp_stub_inet_pton_ret = 1;
	ppp_stub_socket_calls = 0;
	ppp_stub_close_calls = 0;
	sock_err_pending = false;
	poll_fail_pending = false;
	poll_held = false;
	ppp_stub_max_poll_events = 0;
	memset(sock_open, 0, sizeof(sock_open));
	k_mutex_unlock(&stub_lock);
}

int ppp_stub_open_socket_fd(unsigned int idx)
{
	int fd = -1;

	k_mutex_lock(&stub_lock, K_FOREVER);
	for (size_t i = 0; i < ARRAY_SIZE(sock_open); i++) {
		if (sock_open[i] && idx-- == 0) {
			fd = STUB_SOCKET_FD_BASE + (int)i;
			break;
		}
	}
	k_mutex_unlock(&stub_lock);
	return fd;
}

void ppp_stub_hold_poll(void)
{
	k_mutex_lock(&stub_lock, K_FOREVER);
	poll_held = true;
	k_mutex_unlock(&stub_lock);
}

void ppp_stub_release_poll(void)
{
	k_mutex_lock(&stub_lock, K_FOREVER);
	poll_held = false;
	k_condvar_broadcast(&stub_cond);
	k_mutex_unlock(&stub_lock);
}

unsigned int ppp_stub_open_socket_count(void)
{
	unsigned int count = 0;

	k_mutex_lock(&stub_lock, K_FOREVER);
	for (size_t i = 0; i < ARRAY_SIZE(sock_open); i++) {
		count += sock_open[i] ? 1 : 0;
	}
	k_mutex_unlock(&stub_lock);
	return count;
}

void ppp_stub_signal_socket_error(void)
{
	k_mutex_lock(&stub_lock, K_FOREVER);
	sock_err_pending = true;
	k_condvar_broadcast(&stub_cond);
	k_mutex_unlock(&stub_lock);
}

void ppp_stub_signal_poll_failure(void)
{
	k_mutex_lock(&stub_lock, K_FOREVER);
	poll_fail_pending = true;
	k_condvar_broadcast(&stub_cond);
	k_mutex_unlock(&stub_lock);
}

/* --- eventfd ------------------------------------------------------------ */

int eventfd(unsigned int initval, int flags)
{
	ARG_UNUSED(flags);

	k_mutex_lock(&stub_lock, K_FOREVER);
	evfd_count = initval;
	evfd_created = true;
	k_mutex_unlock(&stub_lock);
	return STUB_EVENTFD;
}

int eventfd_write(int fd, eventfd_t value)
{
	if (fd != STUB_EVENTFD || !evfd_created) {
		errno = EBADF;
		return -1;
	}

	k_mutex_lock(&stub_lock, K_FOREVER);
	evfd_count += value;
	k_condvar_broadcast(&stub_cond);
	k_mutex_unlock(&stub_lock);
	return 0;
}

int eventfd_read(int fd, eventfd_t *value)
{
	int ret = 0;

	if (fd != STUB_EVENTFD || !evfd_created) {
		errno = EBADF;
		return -1;
	}

	k_mutex_lock(&stub_lock, K_FOREVER);
	if (evfd_count == 0) {
		errno = EAGAIN;
		ret = -1;
	} else {
		*value = evfd_count;
		evfd_count = 0;
	}
	k_mutex_unlock(&stub_lock);
	return ret;
}

/* --- poll --------------------------------------------------------------- */

int z_impl_zvfs_poll(struct zvfs_pollfd *fds, int nfds, int poll_timeout)
{
	const k_timeout_t timeout = (poll_timeout < 0) ? K_FOREVER : K_MSEC(poll_timeout);
	int nevents = 0;

	for (int i = 0; i < nfds; i++) {
		fds[i].revents = 0;
	}

	k_mutex_lock(&stub_lock, K_FOREVER);

	while (true) {
		/* Held by ppp_stub_hold_poll() so that a test can compose a
		 * single poll result out of several independent events.
		 */
		if (poll_held) {
			if (k_condvar_wait(&stub_cond, &stub_lock, timeout) != 0) {
				break;
			}
			continue;
		}

		/* A polling failure can only be reported while PPP is running,
		 * as that is the only time the data sockets are polled.
		 */
		if (poll_fail_pending && nfds > 1) {
			poll_fail_pending = false;
			k_mutex_unlock(&stub_lock);
			errno = EIO;
			return -1;
		}

		/* A socket error can only be reported when the data sockets are
		 * part of the polled set, i.e. while PPP is running.
		 */
		const bool deliver_err = sock_err_pending && (nfds > 1);

		if (evfd_count > 0 || deliver_err) {
			for (int i = 0; i < nfds; i++) {
				if (fds[i].fd == STUB_EVENTFD) {
					if (evfd_count > 0) {
						fds[i].revents = ZSOCK_POLLIN;
						nevents++;
					}
				} else if (deliver_err) {
					fds[i].revents = ZSOCK_POLLERR;
					nevents++;
				}
			}
			if (deliver_err) {
				sock_err_pending = false;
			}
			break;
		}

		if (k_condvar_wait(&stub_cond, &stub_lock, timeout) != 0) {
			break;
		}
	}

	if ((unsigned int)nevents > ppp_stub_max_poll_events) {
		ppp_stub_max_poll_events = (unsigned int)nevents;
	}
	k_mutex_unlock(&stub_lock);
	return nevents;
}

/* --- sockets ------------------------------------------------------------ */

int z_impl_zsock_socket(int family, int type, int proto)
{
	ARG_UNUSED(family);
	ARG_UNUSED(type);
	ARG_UNUSED(proto);

	k_mutex_lock(&stub_lock, K_FOREVER);
	ppp_stub_socket_calls++;

	if (ppp_stub_socket_fail_nth == ppp_stub_socket_calls) {
		k_mutex_unlock(&stub_lock);
		errno = ENOMEM;
		return -1;
	}

	for (size_t i = 0; i < ARRAY_SIZE(sock_open); i++) {
		if (!sock_open[i]) {
			sock_open[i] = true;
			k_mutex_unlock(&stub_lock);
			return STUB_SOCKET_FD_BASE + (int)i;
		}
	}

	k_mutex_unlock(&stub_lock);
	errno = EMFILE;
	return -1;
}

int z_impl_zsock_close(int sock)
{
	const int idx = sock - STUB_SOCKET_FD_BASE;

	k_mutex_lock(&stub_lock, K_FOREVER);
	ppp_stub_close_calls++;

	if (idx < 0 || idx >= (int)ARRAY_SIZE(sock_open) || !sock_open[idx]) {
		k_mutex_unlock(&stub_lock);
		errno = EBADF;
		return -1;
	}

	sock_open[idx] = false;
	k_mutex_unlock(&stub_lock);
	return 0;
}

int z_impl_zsock_bind(int sock, const struct net_sockaddr *addr, net_socklen_t addrlen)
{
	ARG_UNUSED(sock);
	ARG_UNUSED(addr);
	ARG_UNUSED(addrlen);

	if (ppp_stub_bind_fail) {
		errno = EADDRINUSE;
		return -1;
	}
	return 0;
}

int z_impl_zsock_setsockopt(int sock, int level, int optname, const void *optval,
			    net_socklen_t optlen)
{
	ARG_UNUSED(sock);
	ARG_UNUSED(level);
	ARG_UNUSED(optname);
	ARG_UNUSED(optval);
	ARG_UNUSED(optlen);

	if (ppp_stub_setsockopt_fail) {
		errno = ENOPROTOOPT;
		return -1;
	}
	return 0;
}

ssize_t z_impl_zsock_recvfrom(int sock, void *buf, size_t max_len, int flags,
			      struct net_sockaddr *src_addr, net_socklen_t *addrlen)
{
	ARG_UNUSED(sock);
	ARG_UNUSED(buf);
	ARG_UNUSED(max_len);
	ARG_UNUSED(flags);
	ARG_UNUSED(src_addr);
	ARG_UNUSED(addrlen);

	errno = EAGAIN;
	return -1;
}

ssize_t z_impl_zsock_sendto(int sock, const void *buf, size_t len, int flags,
			    const struct net_sockaddr *dest_addr, net_socklen_t addrlen)
{
	ARG_UNUSED(sock);
	ARG_UNUSED(buf);
	ARG_UNUSED(flags);
	ARG_UNUSED(dest_addr);
	ARG_UNUSED(addrlen);

	return (ssize_t)len;
}

int z_impl_zsock_inet_pton(net_sa_family_t family, const char *src, void *dst)
{
	ARG_UNUSED(src);

	if (ppp_stub_inet_pton_ret != 1) {
		return ppp_stub_inet_pton_ret;
	}

	/* The tests never inspect the parsed address, only whether parsing
	 * succeeded, so a deterministic pattern is enough.
	 */
	memset(dst, 0xAB, (family == NET_AF_INET6) ? 16 : 4);
	return 1;
}
```
