## CMakeLists.txt
```
#
# Copyright (c) 2026 Nordic Semiconductor ASA
#
# SPDX-License-Identifier: LicenseRef-Nordic-5-Clause
#

cmake_minimum_required(VERSION 3.20.0)

find_package(Zephyr REQUIRED HINTS $ENV{ZEPHYR_BASE})
project(at_icmp_test)

# Generate sm_version.h header
set(GENERATED_DIR "${PROJECT_BINARY_DIR}/generated")
file(MAKE_DIRECTORY "${GENERATED_DIR}")
add_custom_target(
    generate_version_header ALL
    COMMAND ${CMAKE_COMMAND}
            -DOUTPUT_FILE=${GENERATED_DIR}/sm_version.h
            -DVERSION_FILE=${CMAKE_CURRENT_SOURCE_DIR}/VERSION
            -P ${CMAKE_CURRENT_SOURCE_DIR}/../../cmake/write_sm_version_header.cmake
    BYPRODUCTS ${GENERATED_DIR}/sm_version.h
    WORKING_DIRECTORY ${CMAKE_CURRENT_SOURCE_DIR}/../..
    COMMENT "Regenerating sm_version.h"
)
zephyr_include_directories("${GENERATED_DIR}")

# Compiler options to set configuration values
target_compile_options(app PRIVATE
  -D__ELASTERROR=2000
  # Suppress upstream Zephyr warnings in net_if.h (returns address of local var)
  -Wno-return-local-addr
)

# Generate CMock mocks for external dependencies
cmock_handle(${ZEPHYR_BASE}/../nrfxlib/nrf_modem/include/nrf_modem.h)
cmock_handle(${ZEPHYR_NRF_MODULE_DIR}/include/modem/nrf_modem_lib.h)
cmock_handle(${ZEPHYR_BASE}/../nrfxlib/nrf_modem/include/nrf_socket.h)
cmock_handle(${ZEPHYR_BASE}/../nrfxlib/nrf_modem/include/nrf_modem_at.h
  FUNC_EXCLUDE "__nrf_modem_printf_like"
  FUNC_EXCLUDE "__nrf_modem_scanf_like"
  FUNC_EXCLUDE "nrf_modem_at_cmd")
cmock_handle(${ZEPHYR_BASE}/include/zephyr/net/socket.h zephyr/net)

# Generate test runner
test_runner_generate(src/test_at_icmp.c)

# Add sources
target_sources(app PRIVATE
  src/test_at_icmp.c
  src/nrf_modem_at_wrapper.c
  ../stubs/uart_stubs.c
  ../stubs/sm_at_host_stubs.c
  ../stubs/control_pin_stubs.c
  ../stubs/pm_stubs.c
  ../stubs/tfm_stubs.c
  ../stubs/at_cmd_custom_stubs.c
  ../stubs/sm_workq.c
  ../stubs/sm_log_stubs.c
  ../../src/sm_util.c
  ../../src/sm_at_socket.c
  ../../src/sm_at_icmp.c
  ../../src/sm_at_host.c
  ../../src/sm_at_commands.c
  ${ZEPHYR_BASE}/subsys/modem/modem_pipe.c
)

# Include directories - override headers first. Reuse the at_socket test's
# stub/override headers (pm_config.h, fw_info.h, hal/, modem/, tfm/).
set(includes
  "${PROJECT_SOURCE_DIR}/../at_socket/include"
  "${PROJECT_SOURCE_DIR}/../../src"
  "${ZEPHYR_BASE}/../nrfxlib/nrf_modem/include"
  "${ZEPHYR_BASE}/include"
  "${ZEPHYR_BASE}/lib/libc/common/include"
  "${PROJECT_SOURCE_DIR}/../stubs"
)

target_include_directories(app PRIVATE ${includes})
```

## Kconfig
```
#
# Copyright (c) 2026 Nordic Semiconductor ASA
#
# SPDX-License-Identifier: LicenseRef-Nordic-5-Clause
#

# SM core symbols — normally defined inside menu "Nordic Serial Modem" in
# app/Kconfig. Redefined here as standalone symbols because the app Kconfig
# cannot be re-sourced (it owns mainmenu and sources Kconfig.zephyr itself).

# NRF_MODEM_LIB_MEM_DIAG is normally gated by NRF_MODEM_LIB; define it here
# so the nrf_modem_lib_diag_stats mock compiles with the full struct definition.
config NRF_MODEM_LIB_MEM_DIAG
	bool "modem lib diagnostics"

config SM_CUSTOMER_VERSION
	string "Customer version string"

config SM_URC_BUFFER_SIZE
	int "URC TX buffer size"
	default 4096

config SM_DATAMODE_BUF_SIZE
	int "Data mode buffer size"
	range 1024 8192
	default 4096

config SM_DATAMODE_TERMINATOR
	string "Data mode terminator pattern"
	default "+++"

# Integer log level: 0=off 1=err 2=wrn 3=inf 4=dbg (Zephyr log_config template)
config SM_LOG_LEVEL
	int "Log level"
	default 3

config SM_CR_LF_TERMINATION
	bool "CR+LF termination"

config SM_BLOCKING_WORK_Q
	bool
	default y

config SM_URC_DELAY_WITH_INCOMPLETE_ECHO_MS
	int "URC delay with incomplete echo (ms)"
	default 1000

config SM_AT_ECHO_MAX_LEN
	int "Maximum AT command echo length"
	range 2 4096
	default 4096

config SM_UART_RX_BUF_SIZE
	int "UART RX buffer size"
	range 128 4096
	default 256

config SM_UART_TX_BUF_SIZE
	int "UART TX buffer size"
	range 128 4096
	default 256

config SM_CMUX_CHANNEL_COUNT
	int "CMUX channel count"
	default 1

# subsys/net/ip/Kconfig is not sourced when the network stack is disabled,
# so define this symbol explicitly to get the AF_INET/SOL_SOCKET etc. aliases.
config NET_NAMESPACE_COMPAT_MODE
	bool "Network namespace compatibility mode"
	default y

source "Kconfig.zephyr"
```

## prj.conf
```kconfig
#
# Copyright (c) 2026 Nordic Semiconductor ASA
#
# SPDX-License-Identifier: LicenseRef-Nordic-5-Clause
#

CONFIG_UNITY=y
CONFIG_ASSERT=n

CONFIG_ASAN=y

CONFIG_DEBUG=y
CONFIG_NO_OPTIMIZATIONS=y

CONFIG_AT_PARSER=y
CONFIG_RING_BUFFER=y
CONFIG_REBOOT=y
CONFIG_EVENTS=y
CONFIG_HEAP_MEM_POOL_SIZE=16384
CONFIG_TEST_RANDOM_GENERATOR=y

# Logging
CONFIG_LOG=y
CONFIG_LOG_MODE_IMMEDIATE=y
CONFIG_LOG_PRINTK=y
CONFIG_LOG_BACKEND_SHOW_COLOR=n
CONFIG_LOG_BACKEND_FORMAT_TIMESTAMP=n

# Native sim settings
CONFIG_NATIVE_SIM_SLOWDOWN_TO_REAL_TIME=n

# SM core settings (see Kconfig)
CONFIG_NRF_MODEM_LIB_MEM_DIAG=y
CONFIG_SM_CR_LF_TERMINATION=y
CONFIG_SM_AT_ECHO_MAX_LEN=256

# The tests check timings with millisecond precision
CONFIG_SYS_CLOCK_TICKS_PER_SEC=1000
```

## src/nrf_modem_at_wrapper.c
```c
/*
 * Copyright (c) 2026 Nordic Semiconductor ASA
 *
 * SPDX-License-Identifier: LicenseRef-Nordic-5-Clause
 */

/**
 * @file nrf_modem_at_wrapper.c
 * Wrapper for nrf_modem_at_cmd to route AT#XPING to its handler and to fake the
 * AT+CGPADDR response that util_get_ip_addr() reads the local address from, and the
 * AT%XGETPDNID response that sm_util_pdn_id_get() reads the PDN ID from.
 */

#include <string.h>
#include <strings.h>
#include <stdarg.h>
#include <errno.h>
#include <stdio.h>
#include <nrf_modem_at.h>

/* Response to AT+CGPADDR, set by the test. NULL makes the command fail. */
const char *test_cgpaddr_response;

/* Response to AT%XGETPDNID, set by the test. NULL makes the command fail. */
const char *test_pdn_id_response;

/* CMock-generated internal function for handling mock expectations.
 * Not in header because CMock doesn't generate declarations for variadic functions.
 */
extern int __cmock_nrf_modem_at_cmd(void *buf, size_t len, const char *fmt, ...);

/* Generated by SM_AT_CMD_CUSTOM() */
extern int handle_at_icmp_ping_wrapper_xping(char *buf, size_t len, char *at_cmd);

int nrf_modem_at_cmd(void *buf, size_t buf_size, const char *fmt, ...)
{
	va_list args;
	char at_cmd[256];
	int ret;

	va_start(args, fmt);
	ret = vsnprintf(at_cmd, sizeof(at_cmd), fmt, args);
	va_end(args);

	if (ret < 0 || ret >= (int)sizeof(at_cmd)) {
		return -EINVAL;
	}

	if (strncasecmp(at_cmd, "AT#XPING", 8) == 0) {
		return handle_at_icmp_ping_wrapper_xping((char *)buf, buf_size, at_cmd);
	}

	if (strncmp(at_cmd, "AT+CGPADDR", 10) == 0) {
		if (test_cgpaddr_response == NULL) {
			return -EINVAL;
		}
		snprintf(buf, buf_size, "%s", test_cgpaddr_response);
		return 0;
	}

	if (strncmp(at_cmd, "AT%XGETPDNID", 12) == 0) {
		if (test_pdn_id_response == NULL) {
			return -EINVAL;
		}
		snprintf(buf, buf_size, "%s", test_pdn_id_response);
		return 0;
	}

	return __cmock_nrf_modem_at_cmd(buf, buf_size, "%s", at_cmd);
}
```
