## CMakeLists.txt
```
# SPDX-License-Identifier: LicenseRef-Nordic-5-Clause
#
# Copyright (c) 2026 Nordic Semiconductor ASA

cmake_minimum_required(VERSION 3.20.0)

find_package(Zephyr REQUIRED HINTS $ENV{ZEPHYR_BASE})
project(at_nrfcloud)

# Generate sm_version.h header
set(GENERATED_DIR "${PROJECT_BINARY_DIR}/generated")
file(MAKE_DIRECTORY "${GENERATED_DIR}")
add_custom_target(
    generate_version_header ALL
    COMMAND ${CMAKE_COMMAND}
            -D OUTPUT_FILE=${GENERATED_DIR}/sm_version.h
            -P ${CMAKE_CURRENT_SOURCE_DIR}/../../cmake/write_sm_version_header.cmake
    BYPRODUCTS ${GENERATED_DIR}/sm_version.h
    WORKING_DIRECTORY ${CMAKE_CURRENT_SOURCE_DIR}/../..
    COMMENT "Regenerating sm_version.h"
)
zephyr_include_directories("${GENERATED_DIR}")
zephyr_include_directories(${ZEPHYR_NRFXLIB_MODULE_DIR}/nrf_modem/include/)

# Compiler options to set configuration values
target_compile_options(app PRIVATE
  -D__ELASTERROR=2000
  # Use the real trace-event declarations with SDK defaults; no Memfault port runs here.
  -DMEMFAULT_PLATFORM_CONFIG_DISABLED
  # Not a Kconfig symbol: shorten the wait for a chunk response so that the timeout path is
  # testable. The observability symbols are declared in Kconfig and set in prj.conf.
  -DOBS_COAP_RESPONSE_TIMEOUT_MS=50
)

# Generate CMock mocks
cmock_handle(${ZEPHYR_BASE}/../nrfxlib/nrf_modem/include/nrf_modem.h)
cmock_handle(${ZEPHYR_NRF_MODULE_DIR}/include/modem/nrf_modem_lib.h)
cmock_handle(${ZEPHYR_BASE}/../nrfxlib/nrf_modem/include/nrf_socket.h)
cmock_handle(${ZEPHYR_BASE}/../nrfxlib/nrf_modem/include/nrf_modem_at.h
  FUNC_EXCLUDE "__nrf_modem_printf_like"
  FUNC_EXCLUDE "__nrf_modem_scanf_like"
  FUNC_EXCLUDE "nrf_modem_at_cmd"
  # at_monitor_sys_init() calls this at SYS_INIT time, before CMock is
  # initialised by setUp(). Exclude it from mocking and provide a manual
  # stub in nrf_modem_at_wrapper.c instead.
  )
cmock_handle(${ZEPHYR_BASE}/include/zephyr/net/socket.h zephyr/net)
cmock_handle(${PROJECT_SOURCE_DIR}/../../src/sm_at_socket.h)
# Mock nRF Cloud CoAP API – the stub header carries all required type
# definitions directly; no REST-layer include chain is needed.
cmock_handle(${PROJECT_SOURCE_DIR}/include/net/nrf_cloud_coap.h)

# Generate test runner
test_runner_generate(src/test_at_nrfcloud.c)

# Add sources
target_sources(app PRIVATE
  src/test_at_nrfcloud.c
  src/nrf_modem_at_wrapper.c
  src/nrf_cloud_stubs.c          # date_time_update_async + nrf_cloud_client_id_get only
  src/memfault_stubs.c           # Memfault symbols (AT#XNRFCLOUDOBS*)
  src/settings_stubs.c
  ../stubs/uart_stubs.c
  ../stubs/sm_at_host_stubs.c
  ../stubs/control_pin_stubs.c
  ../stubs/pm_stubs.c
  ../stubs/tfm_stubs.c
  ../stubs/at_cmd_custom_stubs.c
  ../stubs/sm_workq.c
  ../stubs/sm_log_stubs.c
  ../../src/sm_util.c
  ../../src/sm_at_nrfcloud.c
  ../../src/sm_at_nrfcloud_obs.c
  ../../src/sm_settings.c
  ../../src/sm_at_host.c
  ../../src/sm_at_commands.c
  ${ZEPHYR_BASE}/subsys/modem/modem_pipe.c
)

# Include directories:
#   1. Test-specific overrides (stub headers) come first so they shadow the
#      real nrf_cloud / date_time / wifi headers.
#   2. Shared test include overrides (pm_config.h, fw_info.h, etc.) from the
#      at_commands test.
#   3. Source directories and external include paths follow.
set(includes
  "${PROJECT_SOURCE_DIR}/include"
  "${PROJECT_SOURCE_DIR}/../at_commands/include"
  "${PROJECT_SOURCE_DIR}/../../src"
  "${ZEPHYR_BASE}/../nrfxlib/nrf_modem/include"
  "${ZEPHYR_BASE}/include"
  "${ZEPHYR_BASE}/lib/libc/common/include"
  "${PROJECT_SOURCE_DIR}/../stubs"
  "${PROJECT_SOURCE_DIR}/../../memfault"
  "${ZEPHYR_BASE}/../modules/lib/memfault-firmware-sdk/components/include"
)

target_include_directories(app PRIVATE ${includes})
```

## Kconfig
```
#
# Copyright (c) 2026 Nordic Semiconductor ASA
#
# SPDX-License-Identifier: LicenseRef-Nordic-5-Clause
#

# The application Kconfig is not part of this build, so the symbols of the tested sources are
# declared here. They are redefinitions of the ones in ../../Kconfig, without the SM_NRF_CLOUD
# and MEMFAULT_USE_NRF_CLOUD_COAP dependencies, which cannot be met on native_sim as the modem
# and Memfault are mocked. prj.conf assigns their values.

# NRF_MODEM_LIB_MEM_DIAG is normally gated by NRF_MODEM_LIB; define it here
# so the nrf_modem_lib_diag_stats mock compiles with the full struct definition.
config NRF_MODEM_LIB_MEM_DIAG
	bool "modem lib diagnostics"

config SM_CUSTOMER_VERSION
	string "Customer version string"

config SM_URC_BUFFER_SIZE
	int "URC TX buffer size"
	default 4096

config SM_DATAMODE_BUF_SIZE
	int "Data mode buffer size"
	range 1024 8192
	default 4096

config SM_DATAMODE_TERMINATOR
	string "Data mode terminator pattern"
	default "+++"

# Integer log level: 0=off 1=err 2=wrn 3=inf 4=dbg (Zephyr log_config template)
config SM_LOG_LEVEL
	int "Log level"
	default 3

config SM_CR_LF_TERMINATION
	bool "CR+LF termination"

config SM_URC_DELAY_WITH_INCOMPLETE_ECHO_MS
	int "URC delay with incomplete echo (ms)"
	default 1000

config SM_AT_ECHO_MAX_LEN
	int "Maximum AT command echo length"
	range 2 4096
	default 4096

config SM_UART_RX_BUF_SIZE
	int "UART RX buffer size"
	range 128 4096
	default 256

config SM_UART_TX_BUF_SIZE
	int "UART TX buffer size"
	range 128 4096
	default 256

config SM_CMUX_CHANNEL_COUNT
	int "CMUX channel count"
	default 1

config SM_NRF_CLOUD_LOCATION
	bool "nRF Cloud Location support"

# NRF_CLOUD_SEC_TAG is normally provided by nrf/subsys/net/lib/nrf_cloud/Kconfig,
# which is not sourced in the test build. Redeclare it here with the same default.
config NRF_CLOUD_SEC_TAG
	int "Security tag to use for nRF Cloud connection"
	default 16842753

config SM_NRF_CLOUD_OBSERVABILITY
	bool "nRF Cloud observability AT commands"
	depends on SETTINGS
	help
	  Redefinition of the application symbol, which enables the AT#XNRFCLOUDOBS* commands.

config SM_NRF_CLOUD_OBSERVABILITY_AUTO_INTERVAL_SECONDS
	int "Default interval of the automatic upload"
	depends on SM_NRF_CLOUD_OBSERVABILITY
	default 3600
	range 60 86400

config SM_NRF_CLOUD_OBSERVABILITY_DEBUG
	bool "Debug nRF Cloud observability AT commands"
	depends on SM_NRF_CLOUD_OBSERVABILITY

choice MEMFAULT_SYSTEM_TIME_SOURCE
	bool "Memfault system time from date_time (test stub)"
	default MEMFAULT_SYSTEM_TIME_SOURCE_DATETIME

config MEMFAULT_SYSTEM_TIME_SOURCE_DATETIME
	bool "Datetime"

endchoice

menu "Zephyr Kernel"
source "Kconfig.zephyr"
endmenu
```

## prj.conf
```kconfig
#
# Copyright (c) 2026 Nordic Semiconductor ASA
#
# SPDX-License-Identifier: LicenseRef-Nordic-5-Clause
#

CONFIG_UNITY=y
CONFIG_ASSERT=n

CONFIG_ASAN=y

CONFIG_DEBUG=y
CONFIG_NO_OPTIMIZATIONS=y

CONFIG_RING_BUFFER=y
CONFIG_REBOOT=y
CONFIG_EVENTS=y
CONFIG_HEAP_MEM_POOL_SIZE=32768

CONFIG_AT_PARSER=y

# Observability AT commands (AT#XNRFCLOUDOBS*).
CONFIG_SM_NRF_CLOUD_OBSERVABILITY=y
CONFIG_SM_NRF_CLOUD_OBSERVABILITY_DEBUG=y
CONFIG_SM_NRF_CLOUD_OBSERVABILITY_AUTO_INTERVAL_SECONDS=3600

# Required by the observability AT commands to decode a forwarded chunk.
CONFIG_BASE64=y

# AT#XNRFCLOUDOBSAUTO stores its configuration in settings. There is no storage back-end
# here, so settings_save_one() fails and the tests drive the load path by calling the
# settings handler of the module directly.
CONFIG_SETTINGS=y
CONFIG_SETTINGS_NONE=y

# Increase AT monitor heap because %NCELLMEAS notifications can be large
CONFIG_AT_MONITOR=y
CONFIG_AT_MONITOR_HEAP_SIZE=1024

# Logging
CONFIG_LOG=y
CONFIG_LOG_MODE_IMMEDIATE=y
CONFIG_LOG_PRINTK=y
CONFIG_LOG_BACKEND_SHOW_COLOR=n
CONFIG_LOG_BACKEND_FORMAT_TIMESTAMP=n

# Native sim settings
CONFIG_NATIVE_SIM_SLOWDOWN_TO_REAL_TIME=n

# SM core settings (see Kconfig)
CONFIG_NRF_MODEM_LIB_MEM_DIAG=y
CONFIG_SM_LOG_LEVEL=0
CONFIG_SM_CR_LF_TERMINATION=y
CONFIG_SM_AT_ECHO_MAX_LEN=256

# nRF Cloud settings (see Kconfig)
CONFIG_SM_NRF_CLOUD_LOCATION=y

#CONFIG_MAIN_STACK_SIZE=4096
#CONFIG_IDLE_STACK_SIZE=4096
#CONFIG_ISR_STACK_SIZE=4096
#CONFIG_SYSTEM_WORKQUEUE_STACK_SIZE=4096
#CONFIG_MPSL_WORK_STACK_SIZE=4096
#CONFIG_ARCH_POSIX_RECOMMENDED_STACK_SIZE=1024
```

## include/date_time.h
```c
/*
 * Copyright (c) 2026 Nordic Semiconductor ASA
 *
 * SPDX-License-Identifier: LicenseRef-Nordic-5-Clause
 */

/*
 * Minimal stub for date_time.h used in unit tests.
 * Only declares the symbols needed by sm_at_nrfcloud.c.
 */

#ifndef DATE_TIME_TEST_STUB_H_
#define DATE_TIME_TEST_STUB_H_

#include <stdint.h>

/** Event types reported by the date-time library. */
enum date_time_evt_type {
	DATE_TIME_OBTAINED_MODEM,
	DATE_TIME_OBTAINED_NTP,
	DATE_TIME_OBTAINED_EXT,
	DATE_TIME_NOT_OBTAINED,
};

struct date_time_evt {
	enum date_time_evt_type type;
};

typedef void (*date_time_evt_handler_t)(const struct date_time_evt *evt);

/**
 * @brief Stub: trigger async date/time update.
 *
 * In the test environment this is a no-op stub; the semaphore
 * sem_date_time therefore times out (after K_SECONDS(10)) inside
 * nrfcloud_conn_work_fn.  Tests that exercise the full connect work
 * should give the semaphore manually or wait for the timeout.
 */
int date_time_update_async(date_time_evt_handler_t evt_handler);

#endif /* DATE_TIME_TEST_STUB_H_ */
```

## include/nrf_cloud_coap_transport.h
```c
/*
 * Copyright (c) 2026 Nordic Semiconductor ASA
 *
 * SPDX-License-Identifier: LicenseRef-Nordic-5-Clause
 */

/*
 * Stub for nrf_cloud_coap_transport.h.
 * Provides the nrf_cloud_coap_post() declaration via the nrf_cloud_coap.h stub
 * so that sm_at_nrfcloud.c compiles in the unit test environment.
 */

#ifndef NRF_CLOUD_COAP_TRANSPORT_TEST_STUB_H_
#define NRF_CLOUD_COAP_TRANSPORT_TEST_STUB_H_

#include "net/nrf_cloud_coap.h"

#endif /* NRF_CLOUD_COAP_TRANSPORT_TEST_STUB_H_ */
```

## src/memfault_stubs.c
```c
/*
 * Copyright (c) 2026 Nordic Semiconductor ASA
 *
 * SPDX-License-Identifier: LicenseRef-Nordic-5-Clause
 */

/**
 * @file memfault_stubs.c
 *
 * Manual stubs for the Memfault symbols used by the AT#XNRFCLOUDOBS* commands in
 * sm_at_nrfcloud_obs.c.
 *
 * The stubs hold the state the tests assert on:
 *   - the order of memfault_log_trigger_collection() vs the upload,
 *   - the number of heartbeat triggers,
 *   - the crash type forwarded to the Memfault demo CLI,
 *   - the chunks handed out by the packetizer (for the dump operation),
 *   - the date_time events forwarded to Memfault,
 * and let the tests inject the upload return value.
 */

#include <stdbool.h>
#include <stddef.h>
#include <stdint.h>
#include <string.h>
#include <stdarg.h>
#include <stdio.h>
#include <sys/types.h>

#include "memfault/core/data_export.h"
#include "memfault/core/data_packetizer.h"
#include "memfault/core/log.h"
#include "memfault/core/trace_event.h"
#include "memfault/core/platform/device_info.h"
#include "memfault/http/http_client.h"
#include "memfault/metrics/metrics.h"
#include "memfault/ports/ncs/date_time_callback.h"
#include "memfault/ports/zephyr/http.h"
#include "memfault/util/base64.h"

/* ---------------------------------------------------------------------------
 * Recorded state, inspected by the tests
 * ---------------------------------------------------------------------------
 */

/* Heartbeat */
int test_memfault_heartbeat_trigger_count;

/* Upload: injected return value, and what was observed while uploading */
ssize_t test_memfault_upload_return;
int test_memfault_log_trigger_count;
/* True when the log collection was triggered before the upload ran. */
bool test_memfault_log_triggered_before_upload;
const char *test_memfault_upload_seen_api_key;
int test_memfault_upload_count;
int test_memfault_event_upload_error;
int test_memfault_event_batches;
int test_memfault_capture_batches;
int test_memfault_capture_return;
int test_memfault_capture_count;
char test_memfault_fault_log[100];
uint32_t test_memfault_source_mask;
static bool test_event_available;

/* Crash: type string forwarded to memfault_demo_cli_cmd_crash() */
char test_memfault_crash_type[12];
int test_memfault_crash_call_count;
/* Injected: return value of memfault_demo_cli_cmd_crash() (non-zero = invalid type) */
int test_memfault_crash_return;

/* date_time events forwarded to memfault_zephyr_date_time_evt_handler() */
int test_memfault_date_time_evt_count;
enum date_time_evt_type test_memfault_date_time_evt_type;

/* Packetizer: chunks handed out by memfault_packetizer_get_chunk() */
#define TEST_MAX_CHUNKS 4
static const char *test_chunks[TEST_MAX_CHUNKS];
static size_t test_chunk_count;
static size_t test_chunk_index;

/* Device info reported by memfault_platform_get_device_info() */
static const sMemfaultDeviceInfo test_device_info = {
	.device_serial = "test-device-id",
	.software_type = "serial_modem",
	.software_version = "1.2.3",
	.hardware_version = "nrf9151dk",
};

sMfltHttpClientConfig g_mflt_http_client_config = {
	.api_key = "",
};

/* ---------------------------------------------------------------------------
 * Stub implementations
 * ---------------------------------------------------------------------------
 */

void memfault_metrics_heartbeat_debug_trigger(void)
{
	test_memfault_heartbeat_trigger_count++;
}

void memfault_log_trigger_collection(void)
{
	test_memfault_log_trigger_count++;
}

ssize_t memfault_zephyr_port_post_data_return_size(void)
{
	/* Capture what the handler installed for this upload. */
	test_memfault_upload_seen_api_key = g_mflt_http_client_config.api_key;
	test_memfault_log_triggered_before_upload = (test_memfault_log_trigger_count > 0);
	test_memfault_upload_count++;
	if (test_memfault_source_mask == kMfltDataSourceMask_Event) {
		if (test_memfault_event_upload_error &&
		    (test_event_available || test_memfault_event_batches > 0)) {
			/* Model consumption before acknowledgment, even on failure. */
			test_event_available = false;
			return test_memfault_event_upload_error;
		}
		if (test_memfault_event_batches > 0) {
			test_memfault_event_batches--;
			test_event_available = (test_memfault_event_batches > 0);
			return 10;
		}
		if (test_event_available) {
			test_event_available = false;
			return 10;
		}
		return 0;
	}

	return test_memfault_upload_return;
}

int memfault_trace_event_with_log_capture(eMfltTraceReasonUser reason, void *pc, void *lr,
					 const char *fmt, ...)
{
	va_list args;

	(void)reason;
	(void)pc;
	(void)lr;
	test_memfault_capture_count++;
	va_start(args, fmt);
	vsnprintf(test_memfault_fault_log, sizeof(test_memfault_fault_log), fmt, args);
	va_end(args);
	if (!test_memfault_capture_return) {
		test_event_available = true;
		test_memfault_event_batches = test_memfault_capture_batches;
	}
	return test_memfault_capture_return;
}

bool memfault_packetizer_data_available(void)
{
	return test_event_available || test_memfault_event_batches > 0;
}

void memfault_platform_get_device_info(sMemfaultDeviceInfo *info)
{
	*info = test_device_info;
}

int memfault_demo_cli_cmd_crash(int argc, char *argv[])
{
	test_memfault_crash_call_count++;
	if (argc >= 2 && argv[1] != NULL) {
		strncpy(test_memfault_crash_type, argv[1], sizeof(test_memfault_crash_type) - 1);
		test_memfault_crash_type[sizeof(test_memfault_crash_type) - 1] = '\0';
	}

	/* Unlike the real one, this stub returns instead of crashing. */
	return test_memfault_crash_return;
}

void memfault_zephyr_date_time_evt_handler(const struct date_time_evt *evt)
{
	test_memfault_date_time_evt_count++;
	test_memfault_date_time_evt_type = evt->type;
}

bool memfault_packetizer_get_chunk(void *buf, size_t *buf_len)
{
	if (test_chunk_index >= test_chunk_count) {
		return false;
	}

	const char *chunk = test_chunks[test_chunk_index++];
	size_t len = strlen(chunk);

	if (len > *buf_len) {
		return false;
	}

	memcpy(buf, chunk, len);
	*buf_len = len;

	return true;
}

void memfault_packetizer_set_active_sources(uint32_t mask)
{
	test_memfault_source_mask = mask;
}

/* Minimal base64 encoder; the real one is part of the Memfault SDK. */
void memfault_base64_encode(const void *buf, size_t buf_len, void *base64_out)
{
	static const char tbl[] =
		"ABCDEFGHIJKLMNOPQRSTUVWXYZabcdefghijklmnopqrstuvwxyz0123456789+/";
	const uint8_t *in = buf;
	char *out = base64_out;

	for (size_t i = 0; i < buf_len; i += 3) {
		uint32_t triple = (uint32_t)in[i] << 16;
		size_t remaining = buf_len - i;

		if (remaining > 1) {
			triple |= (uint32_t)in[i + 1] << 8;
		}
		if (remaining > 2) {
			triple |= in[i + 2];
		}

		*out++ = tbl[(triple >> 18) & 0x3f];
		*out++ = tbl[(triple >> 12) & 0x3f];
		*out++ = (remaining > 1) ? tbl[(triple >> 6) & 0x3f] : '=';
		*out++ = (remaining > 2) ? tbl[triple & 0x3f] : '=';
	}
}

/* ---------------------------------------------------------------------------
 * Test helpers
 * ---------------------------------------------------------------------------
 */

/* Queue the chunks that memfault_packetizer_get_chunk() hands out. */
void test_memfault_set_chunks(const char * const chunks[], size_t count)
{
	test_chunk_count = (count > TEST_MAX_CHUNKS) ? TEST_MAX_CHUNKS : count;
	for (size_t i = 0; i < test_chunk_count; i++) {
		test_chunks[i] = chunks[i];
	}
	test_chunk_index = 0;
}

/* Reset all recorded state; call from setUp(). */
void test_memfault_stubs_reset(void)
{
	test_memfault_heartbeat_trigger_count = 0;
	test_memfault_upload_return = 0;
	test_memfault_log_trigger_count = 0;
	test_memfault_log_triggered_before_upload = false;
	test_memfault_upload_seen_api_key = NULL;
	test_memfault_upload_count = 0;
	test_memfault_event_upload_error = 0;
	test_memfault_event_batches = 0;
	test_memfault_capture_batches = 0;
	test_memfault_capture_return = 0;
	test_memfault_capture_count = 0;
	test_memfault_fault_log[0] = '\0';
	test_memfault_source_mask = kMfltDataSourceMask_All;
	test_event_available = false;
	memset(test_memfault_crash_type, 0, sizeof(test_memfault_crash_type));
	test_memfault_crash_call_count = 0;
	test_memfault_crash_return = 0;
	test_memfault_date_time_evt_count = 0;
	test_memfault_date_time_evt_type = DATE_TIME_NOT_OBTAINED;
	test_chunk_count = 0;
	test_chunk_index = 0;
	g_mflt_http_client_config.api_key = "";
}
```

## src/nrf_cloud_stubs.c
```c
/*
 * Copyright (c) 2026 Nordic Semiconductor ASA
 *
 * SPDX-License-Identifier: LicenseRef-Nordic-5-Clause
 */

/**
 * @file nrf_cloud_stubs.c
 *
 * Manual stubs for nRF Cloud functions that are NOT mocked via CMock:
 *
 *  - nrf_cloud_client_id_get()   (declared in net/nrf_cloud.h)
 *  - date_time_update_async()    (declared in date_time.h)
 *
 * All nrf_cloud_coap_* functions are generated by CMock from the
 * include/net/nrf_cloud_coap.h stub header (see CMakeLists.txt).
 */

#include <string.h>
#include <stdint.h>
#include <stdbool.h>
#include "net/nrf_cloud.h"
#include "date_time.h"

/* Device-ID returned by nrf_cloud_client_id_get(). */
static const char *device_id_stub = "test-device-id";

int nrf_cloud_client_id_get(char *id_buf, size_t id_buf_sz)
{
	if (id_buf && id_buf_sz > 0) {
		strncpy(id_buf, device_id_stub, id_buf_sz - 1);
		id_buf[id_buf_sz - 1] = '\0';
	}
	return 0;
}

int date_time_update_async(date_time_evt_handler_t evt_handler)
{
	/*
	 * Immediately invoke the handler with DATE_TIME_OBTAINED_NTP so that
	 * nrfcloud_conn_work_fn's k_sem_take(&sem_date_time, K_SECONDS(10))
	 * returns at once instead of timing out.
	 */
	if (evt_handler != NULL) {
		struct date_time_evt evt = {.type = DATE_TIME_OBTAINED_NTP};

		evt_handler(&evt);
	}
	return 0;
}
```

## src/nrf_modem_at_wrapper.c
```c
/*
 * Copyright (c) 2026 Nordic Semiconductor ASA
 *
 * SPDX-License-Identifier: LicenseRef-Nordic-5-Clause
 */

/**
 * @file nrf_modem_at_wrapper.c
 *
 * Routes AT commands to the custom handlers registered by sm_at_nrfcloud.c and
 * sm_at_nrfcloud_obs.c (and the other source files included in this test build).
 *
 * The AT modem command nrf_modem_at_cmd() is used internally by sm_util.c
 * (sm_util_at_printf / sm_util_at_scanf).  This wrapper intercepts those
 * calls and:
 *   - Routes #XNRFCLOUD, #XNRFCLOUDPOS and #XNRFCLOUDOBS* to the SM handler
 *     wrappers, longest prefix first, because #XNRFCLOUD is a prefix of them all.
 *   - Responds to AT%NCELLMEAS=1|3|4 with a preconfigured response string
 *     so that the work-queue-driven ncellmeas flow can be driven from tests.
 *   - Responds to AT+CSCON? (RRC state query) with RRC-idle.
 *   - Returns -NRF_EINVAL for unknown commands.
 */

#include <string.h>
#include <strings.h>
#include <stdio.h>
#include <stdarg.h>
#include <zephyr/kernel.h>
#include <nrf_modem_at.h>
#include <nrf_errno.h>
#include <modem/at_cmd_custom.h>

/* Handler wrappers generated by AT_CMD_CUSTOM in sm_at_nrfcloud.c */
extern int handle_at_nrf_cloud_wrapper_xnrfcloud(char *buf, size_t len, char *at_cmd);
extern int handle_at_nrf_cloud_pos_wrapper_xnrfcloudpos(char *buf, size_t len, char *at_cmd);

/* Handler wrappers generated by AT_CMD_CUSTOM in sm_at_nrfcloud_obs.c */
extern int handle_at_nrf_cloud_obs_auto_wrapper_xnrfcloudobsauto(char *buf, size_t len,
								 char *at_cmd);
extern int handle_at_nrf_cloud_obs_upload_wrapper_xnrfcloudobsupload(char *buf, size_t len,
								     char *at_cmd);
extern int handle_at_nrf_cloud_obs_heartbeat_wrapper_xnrfcloudobsheartbeat(char *buf, size_t len,
									   char *at_cmd);
extern int handle_at_nrf_cloud_obs_forward_wrapper_xnrfcloudobsforward(char *buf, size_t len,
								      char *at_cmd);
extern int handle_at_nrf_cloud_obs_devinfo_wrapper_xnrfcloudobsdevinfo(char *buf, size_t len,
								       char *at_cmd);
extern int handle_at_nrf_cloud_obs_crash_wrapper_xnrfcloudobscrash(char *buf, size_t len,
								   char *at_cmd);
extern int handle_at_nrf_cloud_obs_export_wrapper_xnrfcloudobsexport(char *buf, size_t len,
								    char *at_cmd);

/* The AT commands the modem library would dispatch on its own, ordered so that a command
 * that is a prefix of another one comes last.
 */
static const struct {
	const char *prefix;
	int (*handler)(char *buf, size_t len, char *at_cmd);
} sm_at_cmd_routes[] = {
	{"AT#XNRFCLOUDOBSAUTO", handle_at_nrf_cloud_obs_auto_wrapper_xnrfcloudobsauto},
	{"AT#XNRFCLOUDOBSUPLOAD", handle_at_nrf_cloud_obs_upload_wrapper_xnrfcloudobsupload},
	{"AT#XNRFCLOUDOBSHEARTBEAT",
	 handle_at_nrf_cloud_obs_heartbeat_wrapper_xnrfcloudobsheartbeat},
	{"AT#XNRFCLOUDOBSFORWARD", handle_at_nrf_cloud_obs_forward_wrapper_xnrfcloudobsforward},
	{"AT#XNRFCLOUDOBSDEVINFO", handle_at_nrf_cloud_obs_devinfo_wrapper_xnrfcloudobsdevinfo},
	{"AT#XNRFCLOUDOBSCRASH", handle_at_nrf_cloud_obs_crash_wrapper_xnrfcloudobscrash},
	{"AT#XNRFCLOUDOBSEXPORT", handle_at_nrf_cloud_obs_export_wrapper_xnrfcloudobsexport},
	{"AT#XNRFCLOUDPOS", handle_at_nrf_cloud_pos_wrapper_xnrfcloudpos},
	{"AT#XNRFCLOUD", handle_at_nrf_cloud_wrapper_xnrfcloud},
};

char test_at_nrfcloud_ncellmeas_resp[256];
int test_at_nrfcloud_ncellmeas_resp_ret;

int nrf_modem_at_cmd(void *buf, size_t buf_size, const char *fmt, ...)
{
	char at_cmd[256];
	va_list args;

	va_start(args, fmt);
	vsnprintf(at_cmd, sizeof(at_cmd), fmt, args);
	va_end(args);

	for (size_t i = 0; i < ARRAY_SIZE(sm_at_cmd_routes); i++) {
		const char *prefix = sm_at_cmd_routes[i].prefix;

		if (strncasecmp(at_cmd, prefix, strlen(prefix)) == 0) {
			return sm_at_cmd_routes[i].handler((char *)buf, buf_size, at_cmd);
		}
	}

	if (strncasecmp(at_cmd, "AT%NCELLMEAS", 12) == 0) {
		/* Simulate sending the AT%NCELLMEAS command to the modem.
		 * Return "OK" to sm_util_at_printf.
		 */
		if (buf && buf_size > 0) {
			strncpy((char *)buf, test_at_nrfcloud_ncellmeas_resp, buf_size - 1);
		}
		return test_at_nrfcloud_ncellmeas_resp_ret;
	}

	if (strncasecmp(at_cmd, "AT+CSCON?", 9) == 0) {
		/* RRC connection state: 0 = idle */
		if (buf && buf_size > 0) {
			snprintf((char *)buf, buf_size, "+CSCON: 0,0\r\nOK\r\n");
		}
		return 0;
	}

	return -NRF_EINVAL;
}
```

## src/settings_stubs.c
```c
/*
 * Copyright (c) 2026 Nordic Semiconductor ASA
 *
 * SPDX-License-Identifier: LicenseRef-Nordic-5-Clause
 */

#include <string.h>
#include <errno.h>
#include <zephyr/kernel.h>
#include <zephyr/settings/settings.h>
#include "sm_at_fota.h"
#include "sm_settings.h"

bool sm_init_failed;
bool sm_bootloader_mode_requested;
int full_mfw_dfu_segment_type;
uint32_t sm_fota_bl_version_before;
enum sm_fota_image_type sm_fota_type;
bool sm_fota_nrfcloud;
uint8_t sm_modem_init_eio_retry_count;

int test_fault_save_error;
int test_fault_delete_error;
int test_fault_save_count;
int test_fault_delete_count;
uint8_t test_fault_record[sizeof(struct sm_modem_fault)];

static int fault_store_save(struct settings_store *cs, const char *name, const char *value,
			    size_t len)
{
	ARG_UNUSED(cs);

	if (strcmp(name, "sm/modem_fault")) {
		return -ENOENT;
	}
	if (!len) {
		test_fault_delete_count++;
		return test_fault_delete_error;
	}
	test_fault_save_count++;
	if (test_fault_save_error) {
		return test_fault_save_error;
	}
	if (len != sizeof(test_fault_record)) {
		return -EINVAL;
	}
	memcpy(test_fault_record, value, len);
	return 0;
}

static const struct settings_store_itf fault_store_itf = {
	.csi_save = fault_store_save,
};
static struct settings_store fault_store = {
	.cs_itf = &fault_store_itf,
};

void test_fault_settings_reset(void)
{
	settings_dst_register(&fault_store);
	test_fault_delete_error = 0;
	(void)sm_settings_modem_fault_clear();
	test_fault_save_error = 0;
	test_fault_save_count = 0;
	test_fault_delete_count = 0;
	memset(test_fault_record, 0, sizeof(test_fault_record));
}
```
