## CMakeLists.txt
```
# SPDX-License-Identifier: LicenseRef-Nordic-5-Clause
#
# Copyright (c) 2025 Nordic Semiconductor ASA

cmake_minimum_required(VERSION 3.20.0)

find_package(Zephyr REQUIRED HINTS $ENV{ZEPHYR_BASE})
project(at_commands)

# Generate sm_version.h header
set(GENERATED_DIR "${PROJECT_BINARY_DIR}/generated")
file(MAKE_DIRECTORY "${GENERATED_DIR}")
add_custom_target(
    generate_version_header ALL
    COMMAND ${CMAKE_COMMAND}
            -DOUTPUT_FILE=${GENERATED_DIR}/sm_version.h
            -DVERSION_FILE=${CMAKE_CURRENT_SOURCE_DIR}/VERSION
            -P ${CMAKE_CURRENT_SOURCE_DIR}/../../cmake/write_sm_version_header.cmake
    BYPRODUCTS ${GENERATED_DIR}/sm_version.h
    WORKING_DIRECTORY ${CMAKE_CURRENT_SOURCE_DIR}/../..
    COMMENT "Regenerating sm_version.h"
)
zephyr_include_directories("${GENERATED_DIR}")

target_compile_options(app PRIVATE
  -D__ELASTERROR=2000
)

# Generate CMock
cmock_handle(${ZEPHYR_BASE}/../nrfxlib/nrf_modem/include/nrf_modem.h)
cmock_handle(${ZEPHYR_NRF_MODULE_DIR}/include/modem/nrf_modem_lib.h)
cmock_handle(${ZEPHYR_BASE}/../nrfxlib/nrf_modem/include/nrf_socket.h)
cmock_handle(${ZEPHYR_BASE}/../nrfxlib/nrf_modem/include/nrf_modem_at.h
  FUNC_EXCLUDE "__nrf_modem_printf_like"
  FUNC_EXCLUDE "__nrf_modem_scanf_like"
  FUNC_EXCLUDE "nrf_modem_at_cmd")
cmock_handle(${ZEPHYR_BASE}/include/zephyr/net/socket.h zephyr/net)
cmock_handle(${ZEPHYR_NRF_MODULE_DIR}/include/modem/modem_jwt.h)
cmock_handle(${PROJECT_SOURCE_DIR}/../../src/sm_at_socket.h)

# Generate test runner
test_runner_generate(src/test_at_commands.c)

# Add sources
target_sources(app PRIVATE
  src/test_at_commands.c
  src/nrf_modem_at_wrapper.c
  ../stubs/uart_stubs.c
  ../stubs/sm_at_host_stubs.c
  ../stubs/control_pin_stubs.c
  ../stubs/pm_stubs.c
  ../stubs/tfm_stubs.c
  ../stubs/at_cmd_custom_stubs.c
  ../stubs/sm_workq.c
  ../stubs/sm_log_stubs.c
  ../../src/sm_util.c
  ../../src/sm_at_commands.c
  ../../src/sm_at_host.c
  ${ZEPHYR_BASE}/subsys/modem/modem_pipe.c
)

# Include directories - override headers first
set(includes
  "${PROJECT_SOURCE_DIR}/include"
  "${PROJECT_SOURCE_DIR}/../../src"
  "${ZEPHYR_BASE}/../nrfxlib/nrf_modem/include"
  "${ZEPHYR_BASE}/include"
  "${ZEPHYR_BASE}/lib/libc/common/include"
  "${PROJECT_SOURCE_DIR}/../stubs"
)

target_include_directories(app BEFORE PRIVATE ${includes})
```

## Kconfig
```
#
# Copyright (c) 2026 Nordic Semiconductor ASA
#
# SPDX-License-Identifier: LicenseRef-Nordic-5-Clause
#

# SM core symbols — normally defined inside menu "Nordic Serial Modem" in
# app/Kconfig. Redefined here as standalone symbols because the app Kconfig
# cannot be re-sourced (it owns mainmenu and sources Kconfig.zephyr itself).

# NRF_MODEM_LIB_MEM_DIAG is normally gated by NRF_MODEM_LIB; define it here
# so the nrf_modem_lib_diag_stats mock compiles with the full struct definition.
config NRF_MODEM_LIB_MEM_DIAG
	bool "modem lib diagnostics"

config SM_CUSTOMER_VERSION
	string "Customer version string"

config SM_URC_BUFFER_SIZE
	int "URC TX buffer size"
	default 4096

config SM_DATAMODE_BUF_SIZE
	int "Data mode buffer size"
	range 1024 8192
	default 4096

config SM_DATAMODE_TERMINATOR
	string "Data mode terminator pattern"
	default "+++"

# Integer log level: 0=off 1=err 2=wrn 3=inf 4=dbg (Zephyr log_config template)
config SM_LOG_LEVEL
	int "Log level"
	default 3

config SM_CR_LF_TERMINATION
	bool "CR+LF termination"

config SM_URC_DELAY_WITH_INCOMPLETE_ECHO_MS
	int "URC delay with incomplete echo (ms)"
	default 1000

config SM_AT_ECHO_MAX_LEN
	int "Maximum AT command echo length"
	range 2 4096
	default 4096

config SM_UART_RX_BUF_SIZE
	int "UART RX buffer size"
	range 128 4096
	default 256

config SM_UART_TX_BUF_SIZE
	int "UART TX buffer size"
	range 128 4096
	default 256

config SM_CMUX_CHANNEL_COUNT
	int "CMUX channel count"
	default 1

config SM_FW_UPDATE
	def_bool y

source "Kconfig.zephyr"
```

## prj.conf
```kconfig
#
# Copyright (c) 2025 Nordic Semiconductor ASA
#
# SPDX-License-Identifier: LicenseRef-Nordic-5-Clause
#

CONFIG_UNITY=y
CONFIG_ASSERT=n

CONFIG_ASAN=y

CONFIG_DEBUG=y
CONFIG_NO_OPTIMIZATIONS=y

CONFIG_AT_PARSER=y
CONFIG_RING_BUFFER=y
CONFIG_REBOOT=y
CONFIG_EVENTS=y
CONFIG_HEAP_MEM_POOL_SIZE=16384

# Logging
CONFIG_LOG=y
CONFIG_LOG_MODE_IMMEDIATE=y
CONFIG_LOG_PRINTK=y
CONFIG_LOG_BACKEND_SHOW_COLOR=n
CONFIG_LOG_BACKEND_FORMAT_TIMESTAMP=n

# Native sim settings
CONFIG_NATIVE_SIM_SLOWDOWN_TO_REAL_TIME=n

# SM core settings (see Kconfig)
CONFIG_NRF_MODEM_LIB_MEM_DIAG=y
CONFIG_SM_CR_LF_TERMINATION=y
CONFIG_SM_CUSTOMER_VERSION="customer_v1.0"
CONFIG_SM_AT_ECHO_MAX_LEN=256
```

## include/fw_info.h
```c
/*
 * Copyright (c) 2026 Nordic Semiconductor ASA
 *
 * SPDX-License-Identifier: LicenseRef-Nordic-5-Clause
 */

#ifndef FW_INFO_H__
#define FW_INFO_H__

#include <stdint.h>

struct fw_info {
	uint32_t version;
};

#endif /* FW_INFO_H__ */
```

## src/nrf_modem_at_wrapper.c
```c
/*
 * Copyright (c) 2025 Nordic Semiconductor ASA
 *
 * SPDX-License-Identifier: LicenseRef-Nordic-5-Clause
 */

/**
 * @file nrf_modem_at_wrapper.c
 * Wrapper for nrf_modem_at_cmd to intercept AT commands in tests
 */

#include <zephyr/kernel.h>
#include <string.h>
#include <strings.h>
#include <stdio.h>
#include <nrf_modem_at.h>
#include <nrf_errno.h>
#include <modem/at_cmd_custom.h>

/* External wrapper functions declared by SM_AT_CMD_CUSTOM macro */
extern int handle_at_smver_wrapper_xsmver(char *buf, size_t len, char *at_cmd);
extern int handle_at_sleep_wrapper_xsleep(char *buf, size_t len, char *at_cmd);
extern int handle_at_shutdown_wrapper_xshutdown(char *buf, size_t len, char *at_cmd);
extern int handle_at_reset_wrapper_xreset(char *buf, size_t len, char *at_cmd);
extern int handle_at_modemreset_wrapper_xmodemreset(char *buf, size_t len, char *at_cmd);
extern int handle_at_uuid_wrapper_xuuid(char *buf, size_t len, char *at_cmd);
extern int handle_at_datactrl_wrapper_xdatactrl(char *buf, size_t len, char *at_cmd);
extern int handle_at_clac_wrapper_xclac(char *buf, size_t len, char *at_cmd);
extern int handle_ate0_wrapper_ate0(char *buf, size_t len, char *at_cmd);
extern int handle_ate1_wrapper_ate1(char *buf, size_t len, char *at_cmd);
extern int handle_at_xbootinfo_wrapper_xbootinfo(char *buf, size_t len, char *at_cmd);

int nrf_modem_at_cmd(void *buf, size_t buf_size, const char *fmt, ...)
{
	char at_cmd[256];
	va_list args;
	int ret;

	va_start(args, fmt);
	vsnprintf(at_cmd, sizeof(at_cmd), fmt, args);
	va_end(args);

	/* Route to appropriate handler based on command */
	if (strncasecmp(at_cmd, "AT#XSMVER", 9) == 0) {
		ret = handle_at_smver_wrapper_xsmver((char *)buf, buf_size, at_cmd);
	} else if (strncasecmp(at_cmd, "AT#XSLEEP", 9) == 0) {
		ret = handle_at_sleep_wrapper_xsleep((char *)buf, buf_size, at_cmd);
	} else if (strncasecmp(at_cmd, "AT#XSHUTDOWN", 12) == 0) {
		ret = handle_at_shutdown_wrapper_xshutdown((char *)buf, buf_size, at_cmd);
	} else if (strncasecmp(at_cmd, "AT#XRESET", 9) == 0) {
		ret = handle_at_reset_wrapper_xreset((char *)buf, buf_size, at_cmd);
	} else if (strncasecmp(at_cmd, "AT#XMODEMRESET", 14) == 0) {
		ret = handle_at_modemreset_wrapper_xmodemreset((char *)buf, buf_size, at_cmd);
	} else if (strncasecmp(at_cmd, "AT#XUUID", 8) == 0) {
		ret = handle_at_uuid_wrapper_xuuid((char *)buf, buf_size, at_cmd);
	} else if (strncasecmp(at_cmd, "AT#XDATACTRL", 12) == 0) {
		ret = handle_at_datactrl_wrapper_xdatactrl((char *)buf, buf_size, at_cmd);
	} else if (strncasecmp(at_cmd, "AT#XCLAC", 8) == 0) {
		ret = handle_at_clac_wrapper_xclac((char *)buf, buf_size, at_cmd);
	} else if (strncasecmp(at_cmd, "ATE0", 4) == 0) {
		ret = handle_ate0_wrapper_ate0((char *)buf, buf_size, at_cmd);
	} else if (strncasecmp(at_cmd, "ATE1", 4) == 0) {
		ret = handle_ate1_wrapper_ate1((char *)buf, buf_size, at_cmd);
	} else if (strncasecmp(at_cmd, "AT#XBOOTINFO", 12) == 0) {
		ret = handle_at_xbootinfo_wrapper_xbootinfo((char *)buf, buf_size, at_cmd);
	} else {
		/* Unknown command - return error */
		ret = -NRF_EINVAL;
	}

	return ret;
}
```

## src/test_at_commands.c
```c
/*
 * Copyright (c) 2025 Nordic Semiconductor ASA
 *
 * SPDX-License-Identifier: LicenseRef-Nordic-5-Clause
 */

/**
 * @file test_at_commands.c
 * Unit tests for sm_at_commands.c
 */

#include <unity.h>
#include <string.h>
#include <stdint.h>
#include <zephyr/kernel.h>
#include <zephyr/sys/reboot.h>

#include "sm_at_host.h"
#include "uart_stub.h"

/* CMock-generated mocks */
#include "cmock_nrf_modem_at.h"
#include "cmock_modem_jwt.h"

/* Custom AT command list symbols - needed by AT+CLAC handler */
extern int _nrf_modem_at_cmd_custom_list_start;
extern int _nrf_modem_at_cmd_custom_list_end;

int _nrf_modem_at_cmd_custom_list_start;
int _nrf_modem_at_cmd_custom_list_end;

/* Response capture - provided by sm_at_host_stubs.c */
extern void capture_response_data(const uint8_t *data, size_t len);
extern void clear_captured_response(void);
extern const char *get_captured_response(void);

/*
 * Test: AT#XSMVER command - basic functionality
 * Tests that the command returns version information
 */
void test_xsmver_basic(void)
{
	const char *response;

	/* Send AT#XSMVER command */
	send_at_command("AT#XSMVER\r\n");

	/* Verify response contains version info */
	response = get_captured_response();
	TEST_ASSERT_TRUE(strstr(response, "#XSMVER:") != NULL);
	TEST_ASSERT_TRUE(strstr(response, "customer_v1.0") != NULL);
	TEST_ASSERT_TRUE(strstr(response, "OK") != NULL);
}

/*
 * Test: AT#XSMVER with query (?) - should return error
 * The command only supports SET operation, not READ
 */
void test_xsmver_query_not_supported(void)
{
	const char *response;

	/* Send AT#XSMVER? command (query mode) */
	send_at_command("AT#XSMVER?\r\n");

	/* Verify error response */
	response = get_captured_response();
	TEST_ASSERT_TRUE(strstr(response, "ERROR") != NULL);
}

/*
 * Test: AT#XSMVER with test (=?) - should return error
 * The command only supports SET operation, not TEST
 */
void test_xsmver_test_not_supported(void)
{
	const char *response;

	/* Send AT#XSMVER=? command (test mode) */
	send_at_command("AT#XSMVER=?\r\n");

	/* Verify error response */
	response = get_captured_response();
	TEST_ASSERT_TRUE(strstr(response, "ERROR") != NULL);
}

/*
 * Test: AT#XUUID command - basic functionality
 * Tests that the command returns device UUID
 */
void test_xuuid_basic(void)
{
	const char *response;
	struct nrf_device_uuid dev_uuid;

	/* Setup mock - device UUID */
	strcpy(dev_uuid.str, "50503041-3633-4261-803d-1e2b8f70111a");
	__cmock_modem_jwt_get_uuids_ExpectAndReturn(NULL, NULL, 0);
	__cmock_modem_jwt_get_uuids_IgnoreArg_dev();
	__cmock_modem_jwt_get_uuids_IgnoreArg_mfw();
	__cmock_modem_jwt_get_uuids_ReturnThruPtr_dev(&dev_uuid);

	/* Send AT#XUUID command */
	send_at_command("AT#XUUID\r\n");

	/* Verify response contains UUID */
	response = get_captured_response();
	TEST_ASSERT_TRUE(strstr(response, "#XUUID:") != NULL);
	TEST_ASSERT_TRUE(strstr(response, "50503041-3633-4261-803d-1e2b8f70111a") != NULL);
	TEST_ASSERT_TRUE(strstr(response, "OK") != NULL);
}

/*
 * Test: AT#XUUID when modem_jwt_get_uuids fails
 * Tests error handling when UUID retrieval fails
 */
void test_xuuid_get_uuid_fails(void)
{
	const char *response;

	/* Setup mock - return error */
	__cmock_modem_jwt_get_uuids_ExpectAndReturn(NULL, NULL, -EINVAL);
	__cmock_modem_jwt_get_uuids_IgnoreArg_dev();
	__cmock_modem_jwt_get_uuids_IgnoreArg_mfw();

	/* Send AT#XUUID command */
	send_at_command("AT#XUUID\r\n");

	/* Verify error response */
	response = get_captured_response();
	TEST_ASSERT_TRUE(strstr(response, "ERROR") != NULL);
}

/*
 * Test: AT#XUUID with query (?) - should return error
 * The command only supports SET operation, not READ
 */
void test_xuuid_query_not_supported(void)
{
	const char *response;

	/* Send AT#XUUID? command (query mode) */
	send_at_command("AT#XUUID?\r\n");

	/* Verify error response */
	response = get_captured_response();
	TEST_ASSERT_TRUE(strstr(response, "ERROR") != NULL);
}

/*
 * Test: AT#XUUID with test (=?) - should return error
 * The command only supports SET operation, not TEST
 */
void test_xuuid_test_not_supported(void)
{
	const char *response;

	/* Send AT#XUUID=? command (test mode) */
	send_at_command("AT#XUUID=?\r\n");

	/* Verify error response */
	response = get_captured_response();
	TEST_ASSERT_TRUE(strstr(response, "ERROR") != NULL);
}

/*
 * Test: AT#XDATACTRL command - set time limit
 * Tests setting a valid time limit for data mode control
 */
void test_xdatactrl_set_valid(void)
{
	const char *response;

	/* Send AT#XDATACTRL command with valid time limit (100 ms) */
	send_at_command("AT#XDATACTRL=100\r\n");

	/* Verify successful response */
	response = get_captured_response();
	TEST_ASSERT_TRUE(strstr(response, "OK") != NULL);
}

/*
 * Test: AT#XDATACTRL command - set invalid time limit (too small)
 * Tests that setting a time limit below minimum is rejected
 */
void test_xdatactrl_set_invalid(void)
{
	const char *response;

	/* Send AT#XDATACTRL command with invalid time limit (1 ms, too small) */
	send_at_command("AT#XDATACTRL=1\r\n");

	/* Verify error response */
	response = get_captured_response();
	TEST_ASSERT_TRUE(strstr(response, "ERROR") != NULL);
}

/*
 * Test: AT#XDATACTRL command - set zero time limit
 * Tests that setting zero time limit is rejected
 */
void test_xdatactrl_set_zero(void)
{
	const char *response;

	/* Send AT#XDATACTRL command with zero time limit */
	send_at_command("AT#XDATACTRL=0\r\n");

	/* Verify error response */
	response = get_captured_response();
	TEST_ASSERT_TRUE(strstr(response, "ERROR") != NULL);
}

/*
 * Test: AT#XDATACTRL? command - read current configuration
 * Tests reading the current time limit and minimum time limit
 */
void test_xdatactrl_read(void)
{
	const char *response;

	/* First set a known value */
	send_at_command("AT#XDATACTRL=200\r\n");
	clear_captured_response();

	/* Now read it back */
	send_at_command("AT#XDATACTRL?\r\n");

	/* Verify response contains current and minimum time limits */
	response = get_captured_response();
	TEST_ASSERT_TRUE(strstr(response, "#XDATACTRL:") != NULL);
	TEST_ASSERT_TRUE(strstr(response, "200") != NULL); /* Current value */
	TEST_ASSERT_TRUE(strstr(response, "OK") != NULL);
}

/*
 * Test: AT#XDATACTRL=? command - test command syntax
 * Tests that the test command returns the command syntax
 */
void test_xdatactrl_test(void)
{
	const char *response;

	/* Send AT#XDATACTRL=? command (test mode) */
	send_at_command("AT#XDATACTRL=?\r\n");

	/* Verify response contains syntax */
	response = get_captured_response();
	TEST_ASSERT_TRUE(strstr(response, "#XDATACTRL=<time_limit>") != NULL);
	TEST_ASSERT_TRUE(strstr(response, "OK") != NULL);
}

/*
 * Test: ATE0/ATE1 commands - echo control
 * - Commands: ATE1\r\n (enable), ATE0\r\n (disable)
 * - Tests: Echo functionality - commands should be echoed when enabled, not echoed when disabled
 * - Expected: With ATE1, subsequent commands are echoed; with ATE0, they are not
 */
void test_ate_echo_control(void)
{
	const char *response;

	/* Enable echo with ATE1 */
	send_at_command("ATE1\r\n");
	response = get_captured_response();
	TEST_ASSERT_TRUE(strstr(response, "OK") != NULL);
	clear_captured_response();

	/* Send a test command - it should be echoed back */
	send_at_command("AT#XSMVER\r\n");
	response = get_captured_response();
	printk("Response:\n%s\n", response);
	TEST_ASSERT_TRUE(strstr(response, "AT#XSMVER") != NULL); /* Command echoed */
	TEST_ASSERT_TRUE(strstr(response, "#XSMVER:") != NULL);  /* Response present */
	TEST_ASSERT_TRUE(strstr(response, "OK") != NULL);
	clear_captured_response();

	/* Disable echo with ATE0 */
	send_at_command("ATE0\r\n");
	response = get_captured_response();
	TEST_ASSERT_TRUE(strstr(response, "OK") != NULL);
	clear_captured_response();

	/* Send a test command - it should NOT be echoed back */
	send_at_command("AT#XSMVER\r\n");
	response = get_captured_response();
	printk("Response:\n%s\n", response);
	TEST_ASSERT_TRUE(strstr(response, "AT#XSMVER") == NULL); /* Command NOT echoed */
	TEST_ASSERT_TRUE(strstr(response, "#XSMVER:") != NULL);  /* Response still present */
	TEST_ASSERT_TRUE(strstr(response, "OK") != NULL);
}

/*
 * Test: AT#XBOOTINFO=0 - query MCUboot version
 * Stub reports firmware version 0, so response should indicate version 0.
 */
void test_xbootinfo_version(void)
{
	const char *response;

	send_at_command("AT#XBOOTINFO=0\r\n");

	response = get_captured_response();
	TEST_ASSERT_TRUE(strstr(response, "#XBOOTINFO: 0") != NULL);
	TEST_ASSERT_TRUE(strstr(response, "OK") != NULL);
}

/*
 * Test: AT#XBOOTINFO=1 - query active MCUboot slot
 * Stub reports S0 active, so response should indicate slot 0.
 */
void test_xbootinfo_slot(void)
{
	const char *response;

	send_at_command("AT#XBOOTINFO=1\r\n");

	response = get_captured_response();
	TEST_ASSERT_TRUE(strstr(response, "#XBOOTINFO: 0") != NULL);
	TEST_ASSERT_TRUE(strstr(response, "OK") != NULL);
}

/*
 * Test: AT#XBOOTINFO=2 - invalid op, should return error
 */
void test_xbootinfo_invalid_op(void)
{
	const char *response;

	send_at_command("AT#XBOOTINFO=2\r\n");

	response = get_captured_response();
	TEST_ASSERT_TRUE(strstr(response, "ERROR") != NULL);
}

/*
 * Test: AT#XBOOTINFO=? - test command syntax
 */
void test_xbootinfo_test(void)
{
	const char *response;

	send_at_command("AT#XBOOTINFO=?\r\n");

	response = get_captured_response();
	TEST_ASSERT_TRUE(strstr(response, "#XBOOTINFO: (0,1)") != NULL);
	TEST_ASSERT_TRUE(strstr(response, "OK") != NULL);
}

/*
 * Test: a long modem notification, such as %NCELLMEAS with a GCI search, is sent as URC
 * in full, preceded by CRLF, and not truncated.
 */
void test_urc_long_modem_notification(void)
{
	static char notification[2000];
	static char expected[sizeof(notification) + sizeof("\r\n")];
	const char *response;
	const size_t body_len = sizeof(notification) - sizeof("%NCELLMEAS: \r\n");

	memset(notification, 'A', body_len);
	memcpy(notification, "%NCELLMEAS: ", strlen("%NCELLMEAS: "));
	strcpy(notification + body_len, "\r\n");
	strcpy(expected, "\r\n");
	strcat(expected, notification);

	clear_captured_response();
	/* This is how sm_at_urc_filter.c forwards the modem notifications. */
	urc_send("\r\n%s", notification);
	/* The URC is sent from the work queue. */
	k_sleep(K_MSEC(10));

	response = get_captured_response();
	TEST_ASSERT_EQUAL_STRING(expected, response);
}

extern int unity_main(void);

int main(void)
{
	(void)unity_main();

	return 0;
}
```
