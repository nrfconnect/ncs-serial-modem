## CMakeLists.txt
```
#
# Copyright (c) 2025 Nordic Semiconductor ASA
#
# SPDX-License-Identifier: LicenseRef-Nordic-5-Clause
#

cmake_minimum_required(VERSION 3.20.0)

find_package(Zephyr REQUIRED HINTS $ENV{ZEPHYR_BASE})
project(at_sms_test)

# Generate sm_version.h header
set(GENERATED_DIR "${PROJECT_BINARY_DIR}/generated")
file(MAKE_DIRECTORY "${GENERATED_DIR}")
add_custom_target(
    generate_version_header ALL
    COMMAND ${CMAKE_COMMAND}
            -DOUTPUT_FILE=${GENERATED_DIR}/sm_version.h
            -DVERSION_FILE=${CMAKE_CURRENT_SOURCE_DIR}/VERSION
            -P ${CMAKE_CURRENT_SOURCE_DIR}/../../cmake/write_sm_version_header.cmake
    BYPRODUCTS ${GENERATED_DIR}/sm_version.h
    WORKING_DIRECTORY ${CMAKE_CURRENT_SOURCE_DIR}/../..
    COMMENT "Regenerating sm_version.h"
)
zephyr_include_directories("${GENERATED_DIR}")

# Compiler options to set configuration values
target_compile_options(app PRIVATE
  -D__ELASTERROR=2000
)

# Generate CMock mocks for external dependencies
cmock_handle(${ZEPHYR_BASE}/../nrfxlib/nrf_modem/include/nrf_modem.h)
cmock_handle(${ZEPHYR_NRF_MODULE_DIR}/include/modem/nrf_modem_lib.h)
cmock_handle(${ZEPHYR_BASE}/../nrfxlib/nrf_modem/include/nrf_socket.h)
cmock_handle(${ZEPHYR_BASE}/../nrfxlib/nrf_modem/include/nrf_modem_at.h
  FUNC_EXCLUDE "__nrf_modem_printf_like"
  FUNC_EXCLUDE "__nrf_modem_scanf_like"
  FUNC_EXCLUDE "nrf_modem_at_cmd")
cmock_handle(${ZEPHYR_NRF_MODULE_DIR}/include/modem/modem_jwt.h)
cmock_handle(${PROJECT_SOURCE_DIR}/../../src/sm_at_socket.h)

# Generate test runner
test_runner_generate(src/test_at_sms.c)

# Add sources
target_sources(app PRIVATE
  src/test_at_sms.c
  src/nrf_modem_at_wrapper.c
  ../stubs/uart_stubs.c
  ../stubs/sm_at_host_stubs.c
  ../stubs/control_pin_stubs.c
  ../stubs/pm_stubs.c
  ../stubs/tfm_stubs.c
  ../stubs/at_cmd_custom_stubs.c
  ../stubs/sm_workq.c
  ../stubs/sm_log_stubs.c
  ../stubs/sms_stubs.c
  ../../src/sm_util.c
  ../../src/sm_at_commands.c
  ../../src/sm_at_host.c
  ../../src/sm_at_sms.c
  ${ZEPHYR_BASE}/subsys/modem/modem_pipe.c
)

# Include directories - override headers first
set(includes
  "${PROJECT_SOURCE_DIR}/include"
  "${PROJECT_SOURCE_DIR}/../../src"
  "${ZEPHYR_BASE}/../nrfxlib/nrf_modem/include"
  "${ZEPHYR_BASE}/include"
  "${ZEPHYR_BASE}/lib/libc/common/include"
  "${PROJECT_SOURCE_DIR}/../stubs"
)

target_include_directories(app BEFORE PRIVATE ${includes})
```

## Kconfig
```
#
# Copyright (c) 2026 Nordic Semiconductor ASA
#
# SPDX-License-Identifier: LicenseRef-Nordic-5-Clause
#

# SM core symbols — normally defined inside menu "Nordic Serial Modem" in
# app/Kconfig. Redefined here as standalone symbols because the app Kconfig
# cannot be rsourced (it owns mainmenu and sources Kconfig.zephyr itself).

# NRF_MODEM_LIB_MEM_DIAG is normally gated by NRF_MODEM_LIB; define it here
# so the nrf_modem_lib_diag_stats mock compiles with the full struct definition.
config NRF_MODEM_LIB_MEM_DIAG
	bool "modem lib diagnostics"

config SM_CUSTOMER_VERSION
	string "Customer version string"

config SM_URC_BUFFER_SIZE
	int "URC TX buffer size"
	default 4096

config SM_DATAMODE_BUF_SIZE
	int "Data mode buffer size"
	range 1024 8192
	default 4096

config SM_DATAMODE_TERMINATOR
	string "Data mode terminator pattern"
	default "+++"

# Integer log level: 0=off 1=err 2=wrn 3=inf 4=dbg (Zephyr log_config template)
config SM_LOG_LEVEL
	int "Log level"
	default 3

config SM_CR_LF_TERMINATION
	bool "CR+LF termination"

config SM_URC_DELAY_WITH_INCOMPLETE_ECHO_MS
	int "URC delay with incomplete echo (ms)"
	default 1000

config SM_AT_ECHO_MAX_LEN
	int "Maximum AT command echo length"
	range 2 4096
	default 4096

config SM_UART_RX_BUF_SIZE
	int "UART RX buffer size"
	range 128 4096
	default 256

config SM_UART_TX_BUF_SIZE
	int "UART TX buffer size"
	range 128 4096
	default 256

config SM_CMUX_CHANNEL_COUNT
	int "CMUX channel count"
	default 1

source "Kconfig.zephyr"
```

## prj.conf
```kconfig
#
# Copyright (c) 2025 Nordic Semiconductor ASA
#
# SPDX-License-Identifier: LicenseRef-Nordic-5-Clause
#

CONFIG_UNITY=y
CONFIG_ASSERT=n

CONFIG_ASAN=y

CONFIG_DEBUG=y
CONFIG_NO_OPTIMIZATIONS=y

CONFIG_AT_PARSER=y
CONFIG_RING_BUFFER=y
CONFIG_REBOOT=y
CONFIG_EVENTS=y
CONFIG_HEAP_MEM_POOL_SIZE=16384

# Logging
CONFIG_LOG=y
CONFIG_LOG_MODE_IMMEDIATE=y
CONFIG_LOG_PRINTK=y
CONFIG_LOG_BACKEND_SHOW_COLOR=n
CONFIG_LOG_BACKEND_FORMAT_TIMESTAMP=n

# Native sim settings
CONFIG_NATIVE_SIM_SLOWDOWN_TO_REAL_TIME=n
```

## src/nrf_modem_at_wrapper.c
```c
/*
 * Copyright (c) 2025 Nordic Semiconductor ASA
 *
 * SPDX-License-Identifier: LicenseRef-Nordic-5-Clause
 */

/**
 * @file nrf_modem_at_wrapper.c
 * Wrapper for nrf_modem_at_cmd to intercept AT commands in tests
 */

#include <zephyr/kernel.h>
#include <string.h>
#include <strings.h>
#include <stdio.h>
#include <stdarg.h>
#include <nrf_modem_at.h>
#include <nrf_errno.h>
#include <modem/at_cmd_custom.h>

/* External wrapper function declared by SM_AT_CMD_CUSTOM macro in sm_at_sms.c */
extern int handle_at_sms_wrapper_xsms(char *buf, size_t len, char *at_cmd);

int nrf_modem_at_cmd(void *buf, size_t buf_size, const char *fmt, ...)
{
	char at_cmd[256];
	va_list args;
	int ret;

	va_start(args, fmt);
	vsnprintf(at_cmd, sizeof(at_cmd), fmt, args);
	va_end(args);

	/* Route to appropriate handler based on command */
	if (strncasecmp(at_cmd, "AT#XSMS", 7) == 0) {
		ret = handle_at_sms_wrapper_xsms((char *)buf, buf_size, at_cmd);
	} else {
		/* Unknown command - return error */
		ret = -NRF_EINVAL;
	}

	return ret;
}
```

## src/test_at_sms.c
```c
/*
 * Copyright (c) 2025 Nordic Semiconductor ASA
 *
 * SPDX-License-Identifier: LicenseRef-Nordic-5-Clause
 */

/**
 * @file test_at_sms.c
 * Unit tests for sm_at_sms.c
 *
 * Regression test for the concatenated-SMS reassembly heap overflow (C-2):
 * a maliciously crafted concatenated SMS (attacker-controlled, arrives over
 * the air with no authentication) with maximal-length payload segments used
 * to overflow the heap buffer allocated in sms_concat_handle() due to an
 * off-by-one in the size calculation and unsafe strcat()/strncat() use
 * during the final compaction pass. CONFIG_ASAN=y (see prj.conf) turns any
 * such overflow into a hard test failure instead of silent corruption.
 */

#include <unity.h>
#include <string.h>
#include <stdint.h>
#include <zephyr/kernel.h>
#include <zephyr/logging/log.h>
#include <modem/sms.h>

LOG_MODULE_REGISTER(test_at_sms, LOG_LEVEL_DBG);

#include "sm_at_host.h"
#include "uart_stub.h"

/* CMock-generated mocks */
#include "cmock_nrf_modem_at.h"
#include "cmock_modem_jwt.h"

/* Custom AT command list symbols - needed by AT command dispatch */
extern int _nrf_modem_at_cmd_custom_list_start;
extern int _nrf_modem_at_cmd_custom_list_end;

int _nrf_modem_at_cmd_custom_list_start;
int _nrf_modem_at_cmd_custom_list_end;

/* Response capture - provided by sm_at_host_stubs.c */
extern void capture_response_data(const uint8_t *data, size_t len);
extern void clear_captured_response(void);
extern const char *get_captured_response(void);

/* Test helper provided by sms_stubs.c: directly invokes the listener
 * registered via sms_register_listener(), simulating message delivery
 * from the modem.
 */
extern void sms_stub_deliver(struct sms_data *data);

/* sms_concat_handle/sms_callback are declared STATIC in sm_at_sms.c, which
 * expands to plain "static" under production builds but to nothing under
 * CONFIG_UNITY, making them directly callable from this test binary.
 */
void sms_callback(struct sms_data *const data, void *context);

void setUp(void)
{
	clear_captured_response();
	/* Start the SMS listener so sms_ctx.pipe is set and sms_callback()
	 * is reachable via sms_stub_deliver().
	 */
	send_at_command("AT#XSMS=1\r\n");
	clear_captured_response();
}

void tearDown(void)
{
	send_at_command("AT#XSMS=0\r\n");
}

/* Build a single concatenated-SMS-part sms_data with a maximal-length
 * (SMS_MAX_PAYLOAD_LEN_CHARS) payload, at 1-based sequence number seq of
 * total_msgs total parts, ref_number ref.
 */
static void fill_concat_part(struct sms_data *data, uint16_t ref, uint8_t total_msgs,
			      uint8_t seq, char fill_char)
{
	memset(data, 0, sizeof(*data));
	data->type = SMS_TYPE_DELIVER;

	struct sms_deliver_header *header = &data->header.deliver;

	header->time.year = 25;
	header->time.month = 1;
	header->time.day = 1;
	header->time.hour = 12;
	header->time.minute = 0;
	header->time.second = 0;
	header->time.timezone = 4; /* UTC+01:00 */

	strcpy(header->originating_address.address_str, "1234567890");

	header->concatenated.present = true;
	header->concatenated.ref_number = ref;
	header->concatenated.total_msgs = total_msgs;
	header->concatenated.seq_number = seq;

	memset(data->payload, fill_char, SMS_MAX_PAYLOAD_LEN_CHARS);
	data->payload[SMS_MAX_PAYLOAD_LEN_CHARS] = '\0';
	data->payload_len = SMS_MAX_PAYLOAD_LEN_CHARS;
}

/*
 * Test: a maximal-size concatenated SMS (10 parts - the maximum supported,
 * MAX_CONCATENATED_MESSAGE - each with the maximal SMS_MAX_PAYLOAD_LEN_CHARS
 * payload) is reassembled without a heap buffer overflow (would previously
 * abort under ASAN) and the resulting URC contains all message parts,
 * correctly concatenated and NUL-terminated.
 */
void test_xsms_concat_max_size_no_overflow(void)
{
	struct sms_data data;
	const uint8_t total_msgs = 10;
	const uint16_t ref_number = 42;

	for (uint8_t seq = 1; seq <= total_msgs; seq++) {
		/* Use a distinct fill character per part so we can verify
		 * every part landed in the final, reassembled string.
		 */
		fill_concat_part(&data, ref_number, total_msgs, seq, (char)('A' + seq - 1));
		sms_stub_deliver(&data);
	}

	/* The message must be queued, not sent from the SMS callback, which runs on the
	 * system work queue that drains the pipe.
	 */
	TEST_ASSERT_EQUAL_STRING_MESSAGE("", get_captured_response(),
					 "The message must not be sent from the SMS callback");

	/* The message is sent from sm_work_q and captured via the wrapped sm_at_send();
	 * give the work queue a moment to run.
	 */
	k_sleep(K_MSEC(10));

	const char *response = get_captured_response();

	TEST_ASSERT_TRUE(strstr(response, "#XSMS:") != NULL);
	TEST_ASSERT_TRUE(strstr(response, "1234567890") != NULL);

	/* Every segment's fill character should appear
	 * SMS_MAX_PAYLOAD_LEN_CHARS times, contiguously, in order.
	 */
	const char *p = response;

	for (uint8_t seq = 1; seq <= total_msgs; seq++) {
		char expected[SMS_MAX_PAYLOAD_LEN_CHARS + 1];

		memset(expected, (char)('A' + seq - 1), SMS_MAX_PAYLOAD_LEN_CHARS);
		expected[SMS_MAX_PAYLOAD_LEN_CHARS] = '\0';

		p = strstr(p, expected);
		TEST_ASSERT_NOT_NULL_MESSAGE(p, "Missing or out-of-order message segment");
		p += SMS_MAX_PAYLOAD_LEN_CHARS;
	}

	/* Response must be properly terminated, not truncated/garbled. */
	TEST_ASSERT_TRUE(strstr(response, "\"\r\n") != NULL);
}

/*
 * Test: an out-of-order arrival of parts (last part first) is still
 * reassembled correctly into the right order, and does not overflow.
 */
void test_xsms_concat_out_of_order_no_overflow(void)
{
	struct sms_data data;
	const uint8_t total_msgs = 3;
	const uint16_t ref_number = 7;

	fill_concat_part(&data, ref_number, total_msgs, 3, 'C');
	sms_stub_deliver(&data);
	fill_concat_part(&data, ref_number, total_msgs, 1, 'A');
	sms_stub_deliver(&data);
	fill_concat_part(&data, ref_number, total_msgs, 2, 'B');
	sms_stub_deliver(&data);

	k_sleep(K_MSEC(10));

	const char *response = get_captured_response();
	const char *pos_a = strstr(response, "AAA");
	const char *pos_b = strstr(response, "BBB");
	const char *pos_c = strstr(response, "CCC");

	TEST_ASSERT_NOT_NULL(pos_a);
	TEST_ASSERT_NOT_NULL(pos_b);
	TEST_ASSERT_NOT_NULL(pos_c);
	TEST_ASSERT_TRUE(pos_a < pos_b);
	TEST_ASSERT_TRUE(pos_b < pos_c);
}

/*
 * Test: a concatenated SMS with UDH reference number 0 (a legal value) is
 * reassembled correctly. Previously ref_number == 0 was used as the "no
 * message in progress" sentinel, so for reference 0 the staging buffer was
 * re-allocated for every part (leaking the previous one) and only the last
 * part survived in the emitted #XSMS URC. The test sends the parts out of
 * order, so it also covers a part arriving while a ref 0 message is in progress.
 */
void test_xsms_concat_ref_number_zero(void)
{
	struct sms_data data;
	const uint8_t total_msgs = 3;
	const uint16_t ref_number = 0;
	const uint8_t order[] = {2, 1, 3};

	for (size_t i = 0; i < ARRAY_SIZE(order); i++) {
		fill_concat_part(&data, ref_number, total_msgs, order[i],
				 (char)('A' + order[i] - 1));
		sms_stub_deliver(&data);
	}

	k_sleep(K_MSEC(10));

	const char *response = get_captured_response();

	TEST_ASSERT_TRUE(strstr(response, "#XSMS:") != NULL);
	TEST_ASSERT_TRUE(strstr(response, "1234567890") != NULL);

	/* Every part must be present, contiguous and in sequence order. */
	const char *p = response;

	for (uint8_t seq = 1; seq <= total_msgs; seq++) {
		char expected[SMS_MAX_PAYLOAD_LEN_CHARS + 1];

		memset(expected, (char)('A' + seq - 1), SMS_MAX_PAYLOAD_LEN_CHARS);
		expected[SMS_MAX_PAYLOAD_LEN_CHARS] = '\0';

		p = strstr(p, expected);
		TEST_ASSERT_NOT_NULL_MESSAGE(p, "Missing or out-of-order message segment");
		p += SMS_MAX_PAYLOAD_LEN_CHARS;
	}

	TEST_ASSERT_TRUE(strstr(response, "\"\r\n") != NULL);
}

extern int unity_main(void);

int main(void)
{
	(void)unity_main();

	return 0;
}
```
