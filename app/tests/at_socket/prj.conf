## CMakeLists.txt
```
#
# Copyright (c) 2025 Nordic Semiconductor ASA
#
# SPDX-License-Identifier: LicenseRef-Nordic-5-Clause
#

cmake_minimum_required(VERSION 3.20.0)

find_package(Zephyr REQUIRED HINTS $ENV{ZEPHYR_BASE})
project(at_socket_test)

# Generate sm_version.h header
set(GENERATED_DIR "${PROJECT_BINARY_DIR}/generated")
file(MAKE_DIRECTORY "${GENERATED_DIR}")
add_custom_target(
    generate_version_header ALL
    COMMAND ${CMAKE_COMMAND}
            -DOUTPUT_FILE=${GENERATED_DIR}/sm_version.h
            -DVERSION_FILE=${CMAKE_CURRENT_SOURCE_DIR}/VERSION
            -P ${CMAKE_CURRENT_SOURCE_DIR}/../../cmake/write_sm_version_header.cmake
    BYPRODUCTS ${GENERATED_DIR}/sm_version.h
    WORKING_DIRECTORY ${CMAKE_CURRENT_SOURCE_DIR}/../..
    COMMENT "Regenerating sm_version.h"
)
zephyr_include_directories("${GENERATED_DIR}")

# Compiler options to set configuration values
target_compile_options(app PRIVATE
  -D__ELASTERROR=2000
  # Suppress upstream Zephyr warnings in net_if.h (returns address of local var)
  -Wno-return-local-addr
)

# Generate CMock mocks for external dependencies
cmock_handle(${ZEPHYR_BASE}/../nrfxlib/nrf_modem/include/nrf_modem.h)
cmock_handle(${ZEPHYR_NRF_MODULE_DIR}/include/modem/nrf_modem_lib.h)
cmock_handle(${ZEPHYR_BASE}/../nrfxlib/nrf_modem/include/nrf_socket.h)
cmock_handle(${ZEPHYR_BASE}/../nrfxlib/nrf_modem/include/nrf_modem_at.h
  FUNC_EXCLUDE "__nrf_modem_printf_like"
  FUNC_EXCLUDE "__nrf_modem_scanf_like"
  FUNC_EXCLUDE "nrf_modem_at_cmd")
cmock_handle(${ZEPHYR_BASE}/include/zephyr/net/socket.h zephyr/net)

# Generate test runner
test_runner_generate(src/test_at_socket.c)

# Add sources
target_sources(app PRIVATE
  src/test_at_socket.c
  src/nrf_modem_at_wrapper.c
  ../stubs/uart_stubs.c
  ../stubs/sm_at_host_stubs.c
  ../stubs/control_pin_stubs.c
  ../stubs/pm_stubs.c
  ../stubs/tfm_stubs.c
  ../stubs/at_cmd_custom_stubs.c
  ../stubs/sm_workq.c
  ../stubs/sm_log_stubs.c
  ../../src/sm_util.c
  ../../src/sm_at_socket.c
  ../../src/sm_at_host.c
  ../../src/sm_at_commands.c
  ${ZEPHYR_BASE}/subsys/modem/modem_pipe.c
)

# Include directories - override headers first
set(includes
  "${PROJECT_SOURCE_DIR}/include"
  "${PROJECT_SOURCE_DIR}/../../src"
  "${ZEPHYR_BASE}/../nrfxlib/nrf_modem/include"
  "${ZEPHYR_BASE}/include"
  "${ZEPHYR_BASE}/lib/libc/common/include"
  "${PROJECT_SOURCE_DIR}/../stubs"
)

target_include_directories(app PRIVATE ${includes})
```

## Kconfig
```
#
# Copyright (c) 2026 Nordic Semiconductor ASA
#
# SPDX-License-Identifier: LicenseRef-Nordic-5-Clause
#

# SM core symbols — normally defined inside menu "Nordic Serial Modem" in
# app/Kconfig. Redefined here as standalone symbols because the app Kconfig
# cannot be re-sourced (it owns mainmenu and sources Kconfig.zephyr itself).

# NRF_MODEM_LIB_MEM_DIAG is normally gated by NRF_MODEM_LIB; define it here
# so the nrf_modem_lib_diag_stats mock compiles with the full struct definition.
config NRF_MODEM_LIB_MEM_DIAG
	bool "modem lib diagnostics"

config SM_CUSTOMER_VERSION
	string "Customer version string"

config SM_URC_BUFFER_SIZE
	int "URC TX buffer size"
	default 4096

config SM_DATAMODE_BUF_SIZE
	int "Data mode buffer size"
	range 1024 8192
	default 4096

config SM_DATAMODE_TERMINATOR
	string "Data mode terminator pattern"
	default "+++"

# Integer log level: 0=off 1=err 2=wrn 3=inf 4=dbg (Zephyr log_config template)
config SM_LOG_LEVEL
	int "Log level"
	default 3

config SM_CR_LF_TERMINATION
	bool "CR+LF termination"

config SM_URC_DELAY_WITH_INCOMPLETE_ECHO_MS
	int "URC delay with incomplete echo (ms)"
	default 1000

config SM_AT_ECHO_MAX_LEN
	int "Maximum AT command echo length"
	range 2 4096
	default 4096

config SM_UART_RX_BUF_SIZE
	int "UART RX buffer size"
	range 128 4096
	default 256

config SM_UART_TX_BUF_SIZE
	int "UART TX buffer size"
	range 128 4096
	default 256

config SM_CMUX_CHANNEL_COUNT
	int "CMUX channel count"
	default 1

# subsys/net/ip/Kconfig is not sourced when the network stack is disabled,
# so define this symbol explicitly to get the AF_INET/SOL_SOCKET etc. aliases.
config NET_NAMESPACE_COMPAT_MODE
	bool "Network namespace compatibility mode"
	default y

source "Kconfig.zephyr"
```

## prj.conf
```kconfig
#
# Copyright (c) 2025 Nordic Semiconductor ASA
#
# SPDX-License-Identifier: LicenseRef-Nordic-5-Clause
#

CONFIG_UNITY=y
CONFIG_ASSERT=n

CONFIG_ASAN=y

CONFIG_DEBUG=y
CONFIG_NO_OPTIMIZATIONS=y

CONFIG_AT_PARSER=y
CONFIG_RING_BUFFER=y
CONFIG_REBOOT=y
CONFIG_EVENTS=y
CONFIG_HEAP_MEM_POOL_SIZE=16384

# Logging
CONFIG_LOG=y
CONFIG_LOG_MODE_IMMEDIATE=y
CONFIG_LOG_PRINTK=y
CONFIG_LOG_BACKEND_SHOW_COLOR=n
CONFIG_LOG_BACKEND_FORMAT_TIMESTAMP=n

# Native sim settings
CONFIG_NATIVE_SIM_SLOWDOWN_TO_REAL_TIME=n

# SM core settings (see Kconfig)
CONFIG_NRF_MODEM_LIB_MEM_DIAG=y
CONFIG_SM_CR_LF_TERMINATION=y
CONFIG_SM_AT_ECHO_MAX_LEN=256
```

## include/pm_config.h
```c
/*
 * Copyright (c) 2026 Nordic Semiconductor ASA
 *
 * SPDX-License-Identifier: LicenseRef-Nordic-5-Clause
 */

#ifndef PM_CONFIG_H__
#define PM_CONFIG_H__

#define PM_S0_ADDRESS 0x10000
#define PM_S1_ADDRESS 0x20000

#endif /* PM_CONFIG_H__ */
```

## src/logging_stubs.c
```c
/*
 * Copyright (c) 2025 Nordic Semiconductor ASA
 *
 * SPDX-License-Identifier: LicenseRef-Nordic-5-Clause
 */

#include <stdarg.h>
#include <stddef.h>

/* Logging stubs - disable logging in tests */

void z_log_msg_runtime_create(void *src_level, void *timestamp, void *data_ptr, size_t data_len,
			      const char *fmt, ...)
{
	/* No-op for tests */
}

void z_log_msg_static_create(void *src_level, const void *data, size_t data_len)
{
	/* No-op for tests */
}
```

## src/nrf_modem_at_wrapper.c
```c
/*
 * Copyright (c) 2025 Nordic Semiconductor ASA
 *
 * SPDX-License-Identifier: LicenseRef-Nordic-5-Clause
 */

/**
 * @file nrf_modem_at_wrapper.c
 * Wrapper for nrf_modem_at_cmd to handle custom AT commands in tests
 */

#include <string.h>
#include <strings.h>
#include <stdarg.h>
#include <errno.h>
#include <stdio.h>
#include <nrf_modem_at.h>
#include <modem/at_cmd_custom.h>

/* CMock-generated internal function for handling mock expectations.
 * Not in header because CMock doesn't generate declarations for variadic functions.
 */
extern int __cmock_nrf_modem_at_cmd(void *buf, size_t len, const char *fmt, ...);

/* Forward declarations for custom command wrapper functions */
/* These are generated by SM_AT_CMD_CUSTOM macro */
extern int handle_at_socket_wrapper_xsocket(char *buf, size_t len, char *at_cmd);
extern int handle_at_close_wrapper_xclose(char *buf, size_t len, char *at_cmd);
extern int handle_at_bind_wrapper_xbind(char *buf, size_t len, char *at_cmd);
extern int handle_at_connect_wrapper_xconnect(char *buf, size_t len, char *at_cmd);
extern int handle_at_send_wrapper_xsend(char *buf, size_t len, char *at_cmd);
extern int handle_at_recv_wrapper_xrecv(char *buf, size_t len, char *at_cmd);
extern int handle_at_sendto_wrapper_xsendto(char *buf, size_t len, char *at_cmd);
extern int handle_at_recvfrom_wrapper_xrecvfrom(char *buf, size_t len, char *at_cmd);
extern int handle_at_getaddrinfo_wrapper_xgetaddrinfo(char *buf, size_t len, char *at_cmd);
extern int handle_at_xapoll_wrapper_xapoll(char *buf, size_t len, char *at_cmd);
extern int handle_at_recvcfg_wrapper_xrecvcfg(char *buf, size_t len, char *at_cmd);
extern int handle_at_socketopt_wrapper_xsocketopt(char *buf, size_t len, char *at_cmd);
extern int handle_at_secure_socket_wrapper_xssocket(char *buf, size_t len, char *at_cmd);
extern int handle_at_secure_socketopt_wrapper_xssocketopt(char *buf, size_t len, char *at_cmd);
extern int handle_at_listen_wrapper_xlisten(char *buf, size_t len, char *at_cmd);
extern int handle_at_accept_wrapper_xaccept(char *buf, size_t len, char *at_cmd);

/* Wrapper for nrf_modem_at_cmd that handles custom commands */
int nrf_modem_at_cmd(void *buf, size_t buf_size, const char *fmt, ...)
{
	va_list args;
	char at_cmd[256];
	int ret;

	/* Format the command string */
	va_start(args, fmt);
	ret = vsnprintf(at_cmd, sizeof(at_cmd), fmt, args);
	va_end(args);

	if (ret < 0 || ret >= (int)sizeof(at_cmd)) {
		return -EINVAL;
	}

	/* Check if this is a Serial Modem custom command (starts with AT#) */
	if (strncasecmp(at_cmd, "AT#", 3) == 0) {
		/* Route to appropriate handler based on command */
		/* NOTE: Check longer commands before shorter ones to avoid prefix matches */
		if (strncasecmp(at_cmd, "AT#XSOCKETOPT", 13) == 0) {
			ret = handle_at_socketopt_wrapper_xsocketopt((char *)buf, buf_size, at_cmd);
		} else if (strncasecmp(at_cmd, "AT#XSSOCKETOPT", 14) == 0) {
			ret = handle_at_secure_socketopt_wrapper_xssocketopt((char *)buf, buf_size,
									     at_cmd);
		} else if (strncasecmp(at_cmd, "AT#XSOCKET", 10) == 0) {
			ret = handle_at_socket_wrapper_xsocket((char *)buf, buf_size, at_cmd);
		} else if (strncasecmp(at_cmd, "AT#XSSOCKET", 11) == 0) {
			ret = handle_at_secure_socket_wrapper_xssocket((char *)buf, buf_size,
								       at_cmd);
		} else if (strncasecmp(at_cmd, "AT#XCLOSE", 9) == 0) {
			ret = handle_at_close_wrapper_xclose((char *)buf, buf_size, at_cmd);
		} else if (strncasecmp(at_cmd, "AT#XBIND", 8) == 0) {
			ret = handle_at_bind_wrapper_xbind((char *)buf, buf_size, at_cmd);
		} else if (strncasecmp(at_cmd, "AT#XLISTEN", 10) == 0) {
			ret = handle_at_listen_wrapper_xlisten((char *)buf, buf_size, at_cmd);
		} else if (strncasecmp(at_cmd, "AT#XACCEPT", 10) == 0) {
			ret = handle_at_accept_wrapper_xaccept((char *)buf, buf_size, at_cmd);
		} else if (strncasecmp(at_cmd, "AT#XCONNECT", 11) == 0) {
			ret = handle_at_connect_wrapper_xconnect((char *)buf, buf_size, at_cmd);
		} else if (strncasecmp(at_cmd, "AT#XSENDTO", 10) == 0) {
			ret = handle_at_sendto_wrapper_xsendto((char *)buf, buf_size, at_cmd);
		} else if (strncasecmp(at_cmd, "AT#XSEND", 8) == 0) {
			ret = handle_at_send_wrapper_xsend((char *)buf, buf_size, at_cmd);
		} else if (strncasecmp(at_cmd, "AT#XRECVCFG", 11) == 0) {
			ret = handle_at_recvcfg_wrapper_xrecvcfg((char *)buf, buf_size, at_cmd);
		} else if (strncasecmp(at_cmd, "AT#XRECVFROM", 12) == 0) {
			ret = handle_at_recvfrom_wrapper_xrecvfrom((char *)buf, buf_size, at_cmd);
		} else if (strncasecmp(at_cmd, "AT#XRECV", 8) == 0) {
			ret = handle_at_recv_wrapper_xrecv((char *)buf, buf_size, at_cmd);
		} else if (strncasecmp(at_cmd, "AT#XGETADDRINFO", 15) == 0) {
			ret = handle_at_getaddrinfo_wrapper_xgetaddrinfo((char *)buf, buf_size,
									 at_cmd);
		} else if (strncasecmp(at_cmd, "AT#XAPOLL", 9) == 0) {
			ret = handle_at_xapoll_wrapper_xapoll((char *)buf, buf_size, at_cmd);
		} else {
			/* Unknown custom command - return error */
			return -EINVAL;
		}

		return ret;
	}

	/* Not a custom command - delegate to CMock */
	return __cmock_nrf_modem_at_cmd(buf, buf_size, "%s", at_cmd);
}
```

## src/pm_stubs.c
```c
/*
 * Copyright (c) 2025 Nordic Semiconductor ASA
 *
 * SPDX-License-Identifier: LicenseRef-Nordic-5-Clause
 */

/**
 * @file pm_stubs.c
 * Stub implementations for power management functions
 */

#include <zephyr/device.h>
#include <zephyr/pm/device.h>

/* Stub for pm_device_action_run */
int pm_device_action_run(const struct device *dev, enum pm_device_action action)
{
	/* Stub - return success */
	(void)dev;
	(void)action;
	return 0;
}
```

## src/sm_at_host_stubs.c
```c
/*
 * Copyright (c) 2025 Nordic Semiconductor ASA
 *
 * SPDX-License-Identifier: LicenseRef-Nordic-5-Clause
 */

/**
 * @file sm_at_host_stubs.c
 * Stub implementations and response capture for sm_at_host functions
 */

#include <stdio.h>
#include <stdarg.h>
#include <string.h>
#include <zephyr/kernel.h>
#include "sm_at_host.h"

/* Global response buffer to capture AT command responses */
static char response_buffer[4096];
static size_t response_len;

/* Get the captured response */
const char *get_captured_response(void)
{
	return response_buffer;
}

size_t get_captured_response_len(void)
{
	return response_len;
}

/* Clear the captured response */
void clear_captured_response(void)
{
	memset(response_buffer, 0, sizeof(response_buffer));
	response_len = 0;
}

/* Capture response data from sm_tx_write (called by rsp_send ->
 * sm_at_send_internal -> sm_tx_write)
 *
 * This function accumulates responses to handle multi-part AT responses.
 */
void capture_response_data(const uint8_t *data, size_t len)
{
	size_t available_space = sizeof(response_buffer) - response_len - 1;

	if (len > available_space) {
		len = available_space;
	}

	if (len > 0) {
		memcpy(response_buffer + response_len, data, len);
		response_len += len;
		response_buffer[response_len] = '\0';
	}
}

/* Wrap sm_at_send to capture responses - this will be called
 * by rsp_send, rsp_send_ok, etc.
 *
 * Accumulates multiple responses instead of overwriting. This is necessary
 * because AT command responses may be sent in multiple calls:
 * 1. First call: command-specific response (e.g., "\r\n#XSOCKET: 3,1,6\r\n")
 * 2. Second call: OK response (e.g., "\r\nOK\r\n")
 *
 * Note: In the current test setup, only synchronous responses sent during
 * sm_at_receive() execution are captured. Responses sent asynchronously
 * (e.g., via work queues) after sm_at_receive() returns are not captured.
 */
int __wrap_sm_at_send(const uint8_t *data, size_t len)
{
	/* Accumulate the response instead of overwriting */
	size_t available_space = sizeof(response_buffer) - response_len - 1;

	if (len > available_space) {
		len = available_space;
	}

	if (len > 0) {
		memcpy(response_buffer + response_len, data, len);
		response_len += len;
		response_buffer[response_len] = '\0';
	}

	/* Call the real function (which will call sm_at_send_internal ->
	 * sm_tx_write)
	 */
	extern int __real_sm_at_send(const uint8_t *data, size_t len);
	int ret = __real_sm_at_send(data, len);

	return ret;
}

/* Stub for sm_fota_post_process - needed by sm_at_host_init */
void sm_fota_post_process(void)
{
	/* Stub - no-op for tests */
}

/* Stub for sm_at_fota_init - needed by sm_at_init */
int sm_at_fota_init(void)
{
	/* Stub - return success */
	return 0;
}

/* Stub for sm_at_fota_uninit - needed by sm_at_uninit */
int sm_at_fota_uninit(void)
{
	/* Stub - return success */
	return 0;
}

/* Bootloader mode flag - needed by sm_at_host.c after rebase */
bool sm_bootloader_mode_enabled;

/* Stubs for DFU/bootloader functions - needed after rebase */
int sm_at_handle_xdfu_init(char *buf, size_t len, char *at_cmd)
{
	/* Stub - return success */
	return 0;
}

int sm_at_handle_xdfu_write(char *buf, size_t len, char *at_cmd)
{
	/* Stub - return success */
	return 0;
}

int sm_at_handle_xdfu_apply(char *buf, size_t len, char *at_cmd)
{
	/* Stub - return success */
	return 0;
}

/* Stub for sys_reboot - needed by sm_at_commands.c after rebase */
void sys_reboot(int type)
{
	/* Stub - no-op for tests */
}
```
