/ {
	chosen {
		/* Route the shared log/trace UART backend to UART1 (VCOM1 on DK). */
		zephyr,console = &uart1;
	};
};

/* Enable UART1 as the shared backend for Zephyr logs and modem traces (VCOM1 on the DK).
 * Modem traces require 1 000 000 baud. Hardware flow control is not used.
 */
&uart1 {
	status = "okay";
	current-speed = <1000000>;
};
