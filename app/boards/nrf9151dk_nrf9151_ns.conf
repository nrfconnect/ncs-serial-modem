## app/boards/nrf9151dk_nrf9151_ns.conf
```kconfig
#
# Copyright (c) 2024 Nordic Semiconductor ASA
#
# SPDX-License-Identifier: LicenseRef-Nordic-5-Clause
#

# Configuration file for nRF9151DK.
# This file is merged with prj.conf in the application folder, and options
# set here will take precedence if they are present in both files.

# When working with PC terminal, unmask the following config.
CONFIG_SM_POWER_PIN=8
CONFIG_SM_INDICATE_PIN=0

# When working with external MCU, unmask the following config.
#CONFIG_SM_POWER_PIN=31
#CONFIG_SM_INDICATE_PIN=30
```

## app/src/ftp_c/Kconfig
```kconfig
#
# Copyright (c) 2020 Nordic Semiconductor ASA
#
# SPDX-License-Identifier: LicenseRef-Nordic-5-Clause

config SM_FTPC
	bool "FTP client support"
	default y
	select FTP_CLIENT

config SM_TFTPC
	bool "TFTP client support"
	default y
	select TFTP_LIB
```

## app/src/gpio/Kconfig
```kconfig
#
# Copyright (c) 2021 Nordic Semiconductor ASA
#
# SPDX-License-Identifier: LicenseRef-Nordic-5-Clause

config SM_GPIO
	bool "GPIO support"
	default y
	depends on GPIO
```

## app/src/http_c/Kconfig
```kconfig
#
# Copyright (c) 2020 Nordic Semiconductor ASA
#
# SPDX-License-Identifier: LicenseRef-Nordic-5-Clause

config SM_HTTPC
	bool "HTTP client support in SLM"
	default y
	select HTTP_CLIENT
```

## app/src/twi/Kconfig
```kconfig
#
# Copyright (c) 2021 Nordic Semiconductor ASA
#
# SPDX-License-Identifier: LicenseRef-Nordic-5-Clause

config SM_TWI
	bool "Access TWI interface with Serial Modem AT command"
	select I2C
	default y if "$(dt_nodelabel_enabled,i2c0)" || \
		     "$(dt_nodelabel_enabled,i2c1)" || \
		     "$(dt_nodelabel_enabled,i2c2)" || \
		     "$(dt_nodelabel_enabled,i2c3)"
```

## app/tests/at_commands/testcase.yaml
```yaml
tests:
  serial_modem.unit_test.at_commands:
    sysbuild: true
    platform_allow:
      - native_sim
    integration_platforms:
      - native_sim
```

## app/tests/at_nrfcloud/testcase.yaml
```yaml
tests:
  serial_modem.unit_test.at_nrfcloud:
    sysbuild: true
    platform_allow:
      - native_sim
    integration_platforms:
      - native_sim
```

## app/tests/at_socket/testcase.yaml
```yaml
tests:
  serial_modem.unit_test.at_socket:
    sysbuild: true
    platform_allow:
      - native_sim
    integration_platforms:
      - native_sim
```

## drivers/Kconfig
```kconfig
#
# Copyright (c) 2025 Nordic Semiconductor ASA
#
# SPDX-License-Identifier: LicenseRef-Nordic-5-Clause

if NRF_MODEM_LIB_TRACE

choice NRF_MODEM_LIB_TRACE_BACKEND

config NRF_MODEM_LIB_TRACE_BACKEND_CMUX
	bool "Stream modem coredump to CMUX"
	depends on SM_CMUX
	help
	  Use CMUX trace backend for modem coredump.

endchoice # NRF_MODEM_LIB_TRACE_BACKEND

endif

menu "Drivers"
rsource "dtr_uart/Kconfig"
endmenu
```

## drivers/dtr_uart/Kconfig
```kconfig
#
# Copyright (c) 2025 Nordic Semiconductor ASA
#
# SPDX-License-Identifier: LicenseRef-Nordic-5-Clause

config DTR_UART
	bool "DTR UART implementation - DCE side"
	default y
	depends on DT_HAS_NORDIC_DTR_UART_ENABLED
	select GPIO
	select UART_ASYNC_API
	select RING_BUFFER
	depends on PM_DEVICE_RUNTIME
	depends on !PM_DEVICE_RUNTIME_DEFAULT_ENABLE
	help
	  Data Terminal Ready (DTR) UART implements UART API and extends UART communication
	  with DTR and Ring Indicator (RI) signals.

	  Data Communication Equipment (DCE) is controlled by DTE (Data Terminal Equipment)
	  using DTR signal. When DTR is deasserted, DCE will stop the UART communication and
	  power down the UART peripheral. When DTR is asserted, DCE will power up the UART
	  peripheral and start the UART communication.

	  RI signal is used by DCE to notify DTE that data is available to read.

config DTR_UART_INIT_PRIORITY
	int "DTR UART initialization priority"
	default 81
	help
	  Initialization priority for the DTR UART driver (POST_KERNEL level).

	  This must be higher than CONFIG_SPI_NOR_INIT_PRIORITY (default: 80)
	  when RTT tracing is enabled. Otherwise RTT will not work correctly.

if DTR_UART

module = DTR_UART
module-str = dtr uart
source "subsys/logging/Kconfig.template.log_config"

endif # DTR_UART
```

## drivers/nrf91-sm/Kconfig
```kconfig
#
# Copyright (c) 2026 Nordic Semiconductor ASA
#
# SPDX-License-Identifier: LicenseRef-Nordic-5-Clause

config MODEM_NRF91SM
	bool "Nordic nRF91 Serial Modem support"
	default y
	depends on DT_HAS_NORDIC_NRF91_SM_V2_ENABLED
	select MODEM_CELLULAR
	help
	  Modem driver for Nordic nRF91 series running
	  the Serial Modem application v2.0.0 or later.
```

## drivers/nrf91m1/Kconfig
```kconfig
#
# Copyright (c) 2026 Nordic Semiconductor ASA
#
# SPDX-License-Identifier: LicenseRef-Nordic-5-Clause

config MODEM_NRF91M1
	bool "Nordic nRF91m1 modem support"
	default y
	depends on DT_HAS_NORDIC_NRF91M1_ENABLED
	select MODEM_CELLULAR
	help
	  Modem driver for Nordic nRF91 series running
	  the Serial LTE Modem application version 2.0 or later.

if MODEM_NRF91M1

choice
	prompt "Request eDRX"
	default MODEM_NRF91M1_EDRX_NO

config MODEM_NRF91M1_EDRX_NO
	bool "No eDRX"

config MODEM_NRF91M1_EDRX_512
	bool "5.12 s eDRX cycle"

config MODEM_NRF91M1_EDRX_1024
	bool "10.24 s eDRX cycle"

config MODEM_NRF91M1_EDRX_2048
	bool "20.48 s eDRX cycle"

config MODEM_NRF91M1_EDRX_MANUAL
	bool "Define eDRX value manually"

endchoice # Request eDRX

config MODEM_NRF91M1_EDRX_MANUAL_VALUE
	string "eDRX value for AT+CEDRXS command"
	default "0010"
	depends on MODEM_NRF91M1_EDRX_MANUAL
	help
	  String. Half a byte in 4-bit format.
	  See AT manual for AT+CEDRXS command for details.

choice
	prompt "Set custom paging time window"
	default MODEM_NRF91M1_PTW_DEFAULT
	depends on !MODEM_NRF91M1_EDRX_NO

config MODEM_NRF91M1_PTW_DEFAULT
	bool "Default paging time window"

config MODEM_NRF91M1_PTW_128S
	bool "1.28 s paging time window"

config MODEM_NRF91M1_PTW_256S
	bool "2.56 s paging time window"

config MODEM_NRF91M1_PTW_512S
	bool "5.12 s paging time window"

config MODEM_NRF91M1_PTW_1024S
	bool "10.24 s paging time window"

config MODEM_NRF91M1_PTW_MANUAL
	bool "Define paging time window value manually"

endchoice # Set custom paging time window

config MODEM_NRF91M1_PTW_MANUAL_VALUE
	string "Paging time window value for AT%XPTW command"
	default "0011"
	depends on MODEM_NRF91M1_PTW_MANUAL
	help
	  String. Half a byte in 4-bit format.
	  See AT manual for AT%XPTW command for details.

choice
	prompt "Request PSM"
	default MODEM_NRF91M1_PSM_NO

config MODEM_NRF91M1_PSM_NO
	bool "No PSM"

config MODEM_NRF91M1_PSM_10S
	bool "10 s active time"

config MODEM_NRF91M1_PSM_20S
	bool "20 s active time"

config MODEM_NRF91M1_PSM_1M
	bool "1 min active time"

endchoice # Request PSM

choice
	prompt "PSM periodic TAU"
	default MODEM_NRF91M1_PSM_TAU_1H
	depends on !MODEM_NRF91M1_PSM_NO

config MODEM_NRF91M1_PSM_TAU_1H
	bool "1 h periodic TAU"

config MODEM_NRF91M1_PSM_TAU_6H
	bool "6 h periodic TAU"

config MODEM_NRF91M1_PSM_TAU_12H
	bool "12 h periodic TAU"

endchoice # PSM periodic TAU

config MODEM_NRF91M1_ENABLE_UART_LOGGING
	bool "Enable UART logging in the modem"
	help
	  Use AT#XLOG=1 command to enable UART logging in the modem.
	  Debug logs are sent from the secondary UART.

endif # MODEM_NRF91M1
```

## dts/bindings/nordic,nrf91m1.yaml
```yaml
# Copyright (c) 2026 Nordic Semiconductor ASA
# SPDX-License-Identifier: Apache-2.0

title: Nordic nRF91M1 module

description: |
  Nordic nRF91 series running the Serial LTE Modem application version 2.0 or later.
  This includes the nRF91M1 module.

compatible: "nordic,nrf91m1"

include:
  - name: zephyr,cellular-modem-device.yaml
    property-blocklist:
      - zephyr,use-default-pdp-ctx

properties:
  zephyr,use-default-pdp-ctx:
    type: int
    enum:
      - 0
      - 1
    default: 1
    description: |
      Modem automatically configures and connects the default PDP context (cid=0) when
      registered to the network. This is used by default in Serial Modem application.

  zephyr,mdm-reset-behavior:
    default: ["toggle_on_recovery"]
```

## dts/bindings/sm/nordic,sm-power-key.yaml
```yaml
# Copyright (c) 2025 Nordic Semiconductor ASA
# SPDX-License-Identifier: LicenseRef-Nordic-5-Clause

description: |
    Serial Modem power pin for Zephyr Modem.

compatible: "nordic,sm-power-key"

properties:
  gpios:
    type: phandle-array
    description: Input. Power GPIO pin.
    required: true
```

## lib/Kconfig
```kconfig
# Copyright (c) 2025 Nordic Semiconductor ASA
# SPDX-License-Identifier: LicenseRef-Nordic-5-Clause

menu "Libraries"

rsource "sm_at_client/Kconfig"

endmenu
```

## lib/sm_at_client/Kconfig
```kconfig
#
# Copyright (c) 2023 Nordic Semiconductor
#
# SPDX-License-Identifier: LicenseRef-Nordic-5-Clause
#

menuconfig SM_AT_CLIENT
	bool "Serial Modem AT Client Library"
	depends on SERIAL
	select UART_ASYNC_API
	select RING_BUFFER
	select UART_USE_RUNTIME_CONFIGURE
	select GPIO_GET_CONFIG
	select PM_DEVICE

if SM_AT_CLIENT

#
# UART buffers
#
config SM_AT_CLIENT_UART_RX_BUF_COUNT
	int "Receive buffers for UART"
	range 2 4
	default 3
	help
	  Number of buffers for receiving (RX) UART traffic.
	  If the buffers are full, UART RX will be disabled until the buffers are processed.

config SM_AT_CLIENT_UART_RX_BUF_SIZE
	int "Receive buffer size for UART"
	range 16 4096
	default 256
	help
	  Amount of received (RX), unprocessed, UART traffic that can be held by a single buffer.

config SM_AT_CLIENT_UART_TX_BUF_SIZE
	int "Send buffer size for UART"
	range 16 4096
	default 256
	help
	  Amount of UART traffic waiting to be sent (TX), which can be held.
	  If the buffers are full, all messages will be sent synchronously.

config SM_AT_CLIENT_AT_CMD_RESP_MAX_SIZE
	int "Maximum size of AT command response from Serial Modem"
	default 2100
	help
	  The maximum size of the AT command response.

config SM_AT_CLIENT_SHELL
	bool "Serial Modem AT Client Shell"
	depends on SHELL
	help
	  Adds AT command capability to shell. The shell command is "sm".

choice
	prompt "AT command terminator"
	default SM_AT_CLIENT_CR_TERMINATION
	help
	  Sets the termination ending from the serial terminal
	  Levels are:
	  -  CR Termination
	  -  LF Termination
	  -  CR+LF Termination

config SM_AT_CLIENT_CR_TERMINATION
	bool "CR Termination"

config SM_AT_CLIENT_LF_TERMINATION
	bool "LF Termination"

config SM_AT_CLIENT_CR_LF_TERMINATION
	bool "CR+LF Termination"

endchoice

module = SM_AT_CLIENT
module-str = SM AT Client
source "$(ZEPHYR_BASE)/subsys/logging/Kconfig.template.log_config"

endif # SM_AT_CLIENT
```

## lib/sm_host/Kconfig
```kconfig
#
# Copyright (c) 2023 Nordic Semiconductor
#
# SPDX-License-Identifier: LicenseRef-Nordic-5-Clause
#

menuconfig SM_HOST
	bool "Serial Modem Host Library"
	depends on SERIAL
	depends on UART_ASYNC_API
	depends on RING_BUFFER
	select UART_USE_RUNTIME_CONFIGURE

if SM_HOST

#
# UART buffers
#
config SM_HOST_UART_RX_BUF_COUNT
	int "Receive buffers for UART"
	range 2 4
	default 3
	help
	  Number of buffers for receiving (RX) UART traffic.
	  If the buffers are full, UART RX will be disabled until the buffers are processed.

config SM_HOST_UART_RX_BUF_SIZE
	int "Receive buffer size for UART"
	range 16 4096
	default 256
	help
	  Amount of received (RX), unprocessed, UART traffic that can be held by a single buffer.

config SM_HOST_UART_TX_BUF_SIZE
	int "Send buffer size for UART"
	range 16 4096
	default 256
	help
	  Amount of UART traffic waiting to be sent (TX), which can be held.
	  If the buffers are full, all messages will be sent synchronously.

config SM_HOST_AT_CMD_RESP_MAX_SIZE
	int "Maximum size of AT command response from Serial Modem"
	default 2100
	help
	  The maximum size of the AT command response.

config SM_HOST_SHELL
	bool "Serial Modem Host Shell"
	depends on SHELL
	help
	  Adds AT command capability to shell. The shell command is "sm".

choice
	prompt "AT command terminator"
	default SM_HOST_CR_LF_TERMINATION
	help
	  Sets the termination ending from the serial terminal
	  Levels are:
	  -  CR Termination
	  -  LF Termination
	  -  CR+LF Termination

config SM_HOST_CR_TERMINATION
	bool "CR Termination"

config SM_HOST_LF_TERMINATION
	bool "LF Termination"

config SM_HOST_CR_LF_TERMINATION
	bool "CR+LF Termination"

endchoice

config SM_HOST_POWER_PIN
	int "Power pin"
	default -1
	help
	  Interface GPIO to toggle power pin of the nRF91 Series device.

config SM_HOST_POWER_PIN_TIME
	int "Power pin active time"
	default 100
	help
	  GPIO active time in milliseconds. This setting specifies
	  the period length for the pin to be active.

config SM_HOST_INDICATE_PIN
	int "Indicate pin"
	default -1
	help
	  Interface GPIO pin used by Serial Modem to indicate that data is available or
	  an unexpected reset has occurred.

module = SM_HOST
module-str = SM Host
source "$(ZEPHYR_BASE)/subsys/logging/Kconfig.template.log_config"

endif # SM_HOST
```
