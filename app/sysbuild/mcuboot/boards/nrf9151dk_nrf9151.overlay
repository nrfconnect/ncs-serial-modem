/*
 * Copyright (c) 2026 Nordic Semiconductor ASA
 *
 * SPDX-License-Identifier: LicenseRef-Nordic-5-Clause
 */

/ {
	chosen {
		zephyr,console = &uart1;
	};
};

&uart1 {
	current-speed = <1000000>;
	status = "okay";
};
