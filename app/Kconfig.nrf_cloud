## app/Kconfig.sysbuild
```kconfig
#
# Copyright (c) 2026 Nordic Semiconductor
#
# SPDX-License-Identifier: LicenseRef-Nordic-5-Clause
#

choice BOOTLOADER
	default BOOTLOADER_MCUBOOT if !SOC_NRF9251_CPUAPP
endchoice

config SECURE_BOOT_APPCORE
	default y if !SOC_NRF9251_CPUAPP

config SECURE_BOOT_NUM_VER_COUNTER_SLOTS
	default 40 if !SOC_NRF9251_CPUAPP

source "share/sysbuild/Kconfig"
```

## app/boards/nrf9251dk_nrf9251_cpuapp.conf
```kconfig
#
# Copyright (c) 2026 Nordic Semiconductor
#
# SPDX-License-Identifier: LicenseRef-Nordic-5-Clause
#

CONFIG_SM_FOTA=n
CONFIG_SM_DFU=n
CONFIG_SM_NRF_CLOUD_FOTA=n
```

## app/sample.yaml
```yaml
sample:
  name: Serial Modem
tests:
  serial_modem.nrf91m1:
    sysbuild: true
    build_only: true
    extra_args:
      - EXTRA_CONF_FILE="cmux.conf;ppp.conf;trace-backend-uart.conf;nrf-device-provisioning.conf"
      - EXTRA_DTC_OVERLAY_FILE="nrf91m1.overlay;trace-backend.overlay"
    extra_configs:
      - CONFIG_SM_LOG_LEVEL_DBG=y
    platform_allow:
      - nrf9151dk/nrf9151/ns
  # The nRF91M1 configuration is the one that carries the most Kconfig fragments and
  # devicetree overlays, so this guards that the coredump partition still composes with
  # all of them.
  serial_modem.nrf91m1.coredump:
    sysbuild: true
    build_only: true
    extra_args:
      - EXTRA_CONF_FILE="cmux.conf;ppp.conf;trace-backend-uart.conf;nrf-device-provisioning.conf;nrfcloud-coredump-flash.conf"
      - EXTRA_DTC_OVERLAY_FILE="nrf91m1.overlay;trace-backend.overlay;nrfcloud-coredump-flash.overlay"
      - mcuboot_EXTRA_DTC_OVERLAY_FILE="${APP_DIR}/nrfcloud-coredump-flash.overlay"
    extra_configs:
      - CONFIG_SM_LOG_LEVEL_DBG=y
    platform_allow:
      - nrf9151dk/nrf9151/ns
    integration_platforms:
      - nrf9151dk/nrf9151/ns
  serial_modem.default:
    sysbuild: true
    build_only: true
    platform_allow:
      - nrf9151dk/nrf9151/ns
      - thingy91x/nrf9151/ns
  serial_modem.extmcu:
    sysbuild: true
    build_only: true
    extra_args:
      - EXTRA_DTC_OVERLAY_FILE="external-mcu.overlay"
    platform_allow:
      - nrf9151dk/nrf9151/ns
    tags: exclude_integration
  serial_modem.extmcu.mtrace:
    sysbuild: true
    build_only: true
    extra_args:
      - EXTRA_CONF_FILE="trace-backend-uart.conf"
      - EXTRA_DTC_OVERLAY_FILE="external-mcu.overlay;trace-backend.overlay"
    platform_allow:
      - nrf9151dk/nrf9151/ns
  serial_modem.no_dtr:
    sysbuild: true
    build_only: true
    extra_args:
      - EXTRA_DTC_OVERLAY_FILE="disable-dtr.overlay"
    platform_allow:
      - nrf9151dk/nrf9151/ns
      - thingy91x/nrf9151/ns
    tags: exclude_integration
  serial_modem.ppp_without_cmux:
    sysbuild: true
    build_only: true
    extra_args:
      - EXTRA_CONF_FILE="ppp.conf"
    platform_allow:
      - nrf9151dk/nrf9151/ns
      - thingy91x/nrf9151/ns
    integration_platforms:
      - nrf9151dk/nrf9151/ns
  serial_modem.ppp_cmux:
    sysbuild: true
    build_only: true
    extra_args:
      - EXTRA_CONF_FILE="cmux.conf;ppp.conf"
    platform_allow:
      - nrf9151dk/nrf9151/ns
      - thingy91x/nrf9151/ns
    tags: exclude_integration
  serial_modem.ppp_cmux.mtrace:
    sysbuild: true
    build_only: true
    extra_args:
      - EXTRA_CONF_FILE="cmux.conf;ppp.conf;trace-backend-uart.conf"
      - EXTRA_DTC_OVERLAY_FILE="trace-backend.overlay"
    extra_configs:
      - CONFIG_SM_LOG_LEVEL_DBG=y
    platform_allow:
      - nrf9151dk/nrf9151/ns
      - thingy91x/nrf9151/ns
    integration_platforms:
      - nrf9151dk/nrf9151/ns
  serial_modem.ppp_cmux_with_extmcu:
    sysbuild: true
    build_only: true
    extra_args:
      - EXTRA_CONF_FILE="cmux.conf;ppp.conf"
      - EXTRA_DTC_OVERLAY_FILE="external-mcu.overlay"
    platform_allow:
      - nrf9151dk/nrf9151/ns
    tags: exclude_integration
  serial_modem.ppp_cmux_with_extmcu.mtrace:
    sysbuild: true
    build_only: true
    extra_args:
      - EXTRA_CONF_FILE="cmux.conf;ppp.conf;trace-backend-uart.conf"
      - EXTRA_DTC_OVERLAY_FILE="external-mcu.overlay;trace-backend.overlay"
    extra_configs:
      - CONFIG_SM_LOG_LEVEL_DBG=y
    platform_allow:
      - nrf9151dk/nrf9151/ns
    tags: exclude_integration
  serial_modem.ppp_cmux_with_modem_trace:
    sysbuild: true
    build_only: true
    extra_args:
      - EXTRA_CONF_FILE="cmux.conf;ppp.conf;trace-backend-cmux.conf"
      - EXTRA_DTC_OVERLAY_FILE="trace-backend.overlay"
    platform_allow:
      - nrf9151dk/nrf9151/ns
      - thingy91x/nrf9151/ns
    integration_platforms:
      - nrf9151dk/nrf9151/ns
  # Only nrf9151dk is covered. thingy91x has no free internal flash, so a coredump partition
  # there would require shrinking slot0 and cascading matching changes into the b0/mcuboot
  # images - out of scope for this minimal overlay.
  serial_modem.memfault:
    sysbuild: true
    build_only: true
    extra_args:
      - EXTRA_CONF_FILE=nrfcloud-coredump-flash.conf
      - EXTRA_DTC_OVERLAY_FILE="nrfcloud-coredump-flash.overlay"
      - mcuboot_EXTRA_DTC_OVERLAY_FILE="${APP_DIR}/nrfcloud-coredump-flash.overlay"
    # No CONFIG_MEMFAULT_NCS_PROJECT_KEY is set on purpose: an empty project key
    # makes the device rely on the nRF Cloud server-side routing, which is what a
    # user without a Memfault project key gets. Setting a placeholder key here
    # would be injected as CoAP option 2429 and make every upload fail.
    platform_allow:
      - nrf9151dk/nrf9151/ns
    integration_platforms:
      - nrf9151dk/nrf9151/ns
  # Memfault is enabled in prj.conf, so this guards the opposite configuration: every
  # option Memfault needs is a configdefault in Kconfig.memfault, and assigning any of
  # them in prj.conf instead both warns and leaves an unbuildable configuration, because
  # nothing implements nrf_cloud_coap_get_user_options() without the Memfault CoAP port.
  serial_modem.no_memfault:
    sysbuild: true
    build_only: true
    extra_configs:
      - CONFIG_MEMFAULT=n
    platform_allow:
      - nrf9151dk/nrf9151/ns
    integration_platforms:
      - nrf9151dk/nrf9151/ns
  serial_modem.mfw_full_fota_and_dfu:
    sysbuild: true
    build_only: true
    extra_args:
      - EXTRA_CONF_FILE="full-fota.conf"
      - EXTRA_DTC_OVERLAY_FILE="full-fota.overlay"
    extra_configs:
      - CONFIG_SM_DFU_MODEM_FULL=y
    platform_allow:
      - nrf9151dk/nrf9151/ns
  serial_modem.pgps_agnss:
    sysbuild: true
    build_only: true
    extra_args:
      - EXTRA_DTC_OVERLAY_FILE="pgps.overlay"
      - mcuboot_EXTRA_DTC_OVERLAY_FILE="${APP_DIR}/pgps.overlay"
    extra_configs:
      - CONFIG_NRF_CLOUD_PGPS=y
    platform_allow:
      - nrf9151dk/nrf9151/ns
  serial_modem.pgps_no_agnss:
    sysbuild: true
    build_only: true
    extra_args:
      - EXTRA_DTC_OVERLAY_FILE="pgps.overlay"
      - mcuboot_EXTRA_DTC_OVERLAY_FILE="${APP_DIR}/pgps.overlay"
    extra_configs:
      - CONFIG_NRF_CLOUD_PGPS=y
      - CONFIG_NRF_CLOUD_AGNSS=n
    platform_allow:
      - nrf9151dk/nrf9151/ns
    tags: exclude_integration
  serial_modem.lwm2m_carrier:
    sysbuild: true
    build_only: true
    extra_args:
      - EXTRA_CONF_FILE="carrier.conf"
      - EXTRA_DTC_OVERLAY_FILE="carrier.overlay"
    platform_allow:
      - nrf9151dk/nrf9151/ns
    integration_platforms:
      - nrf9151dk/nrf9151/ns
  serial_modem.lwm2m_carrier.softbank:
    sysbuild: true
    build_only: true
    extra_args:
      - EXTRA_CONF_FILE="carrier.conf;carrier-softbank.conf"
      - EXTRA_DTC_OVERLAY_FILE="carrier.overlay"
      - SB_EXTRA_CONF_FILE=sysbuild-softbank.conf
    platform_allow:
      - nrf9151dk/nrf9151/ns
    tags: exclude_integration
  serial_modem.lwm2m_carrier.lgu:
    sysbuild: true
    build_only: true
    extra_args:
      - EXTRA_CONF_FILE="carrier.conf;carrier-lgu.conf"
      - EXTRA_DTC_OVERLAY_FILE="carrier.overlay"
    platform_allow:
      - nrf9151dk/nrf9151/ns
    tags: exclude_integration
  serial_modem.auto_connect:
    sysbuild: true
    build_only: true
    extra_configs:
      - CONFIG_SM_AUTO_CONNECT=y
      - CONFIG_SM_AUTO_CONNECT_SYSTEM_MODE="1,0,0,0"
      - CONFIG_SM_AUTO_CONNECT_PDN_CONFIG=y
      - CONFIG_SM_AUTO_CONNECT_PDN_APN="internet"
      - CONFIG_SM_AUTO_CONNECT_PDN_FAMILY_IP=y
      - CONFIG_SM_AUTO_CONNECT_PDN_AUTH=1
      - CONFIG_SM_AUTO_CONNECT_PDN_USERNAME="myuser"
      - CONFIG_SM_AUTO_CONNECT_PDN_PASSWORD="mypassword"
    platform_allow:
      - nrf9151dk/nrf9151/ns
    tags: exclude_integration
  serial_modem.disable_b0:
    sysbuild: true
    build_only: true
    extra_args:
      - EXTRA_DTC_OVERLAY_FILE="disable-b0.overlay"
      - mcuboot_EXTRA_DTC_OVERLAY_FILE="${APP_DIR}/disable-b0.overlay"
      - SB_CONFIG_SECURE_BOOT_APPCORE=n
    platform_allow:
      - nrf9151dk/nrf9151/ns
  serial_modem.debug_stats_stacks:
    sysbuild: true
    build_only: true
    extra_configs:
      - CONFIG_SM_DEBUG_STATS_THREAD_STACK=y
      - CONFIG_SYS_HEAP_INFO=y
      - CONFIG_LOG_BUFFER_SIZE=2048
    platform_allow:
      - nrf9151dk/nrf9151/ns
    tags: exclude_integration
```

## app/tests/at_icmp/testcase.yaml
```yaml
tests:
  serial_modem.unit_test.at_icmp:
    sysbuild: true
    platform_allow:
      - native_sim
    integration_platforms:
      - native_sim
```

## app/tests/at_mqtt/testcase.yaml
```yaml
tests:
  serial_modem.unit_test.at_mqtt:
    sysbuild: true
    platform_allow:
      - native_sim
    integration_platforms:
      - native_sim
  serial_modem.unit_test.at_mqtt.mqtt_3_1_1_only:
    sysbuild: true
    extra_configs:
      - CONFIG_SM_TEST_MQTT_VERSION_5_0=n
    platform_allow:
      - native_sim
    integration_platforms:
      - native_sim
```

## app/tests/at_ppp/testcase.yaml
```yaml
tests:
  serial_modem.unit_test.at_ppp:
    sysbuild: true
    platform_allow:
      - native_sim
    integration_platforms:
      - native_sim
```

## app/tests/at_sms/testcase.yaml
```yaml
tests:
  serial_modem.unit_test.at_sms:
    sysbuild: true
    platform_allow:
      - native_sim
    integration_platforms:
      - native_sim
```

## lib/sm_xdfu/Kconfig
```kconfig
#
# Copyright (c) 2026 Nordic Semiconductor ASA
#
# SPDX-License-Identifier: LicenseRef-Nordic-5-Clause
#

menuconfig SM_XDFU_LIB
	bool "Serial Modem XDFU Library"
	depends on MODEM_CELLULAR
	depends on COMMON_LIBC_MALLOC
	depends on FILE_SYSTEM
	depends on ZCBOR
	help
	  Helper library for host device to implement the AT#XDFU update sequence
	  (XDFUINIT/XDFUWRITE/XDFUAPPLY/XRESET) against nRF91 Serial Modem device.
	  Uses Zephyr's modem_cellular device's UART backends.

if SM_XDFU_LIB

module = SM_XDFU_LIB
module-str = SM XDFU Library
source "$(ZEPHYR_BASE)/subsys/logging/Kconfig.template.log_config"

endif # SM_XDFU_LIB
```

## west.yml
```yaml
# Copyright (c) 2025 Nordic Semiconductor
# SPDX-License-Identifier: LicenseRef-Nordic-5-Clause

manifest:
  # Optional projects. Enable with: west config manifest.group-filter -- +nusim
  group-filter: [-nusim]

  self:
    import: submanifests

  remotes:
    - name: ncs
      url-base: https://github.com/nrfconnect

  projects:
    - name: nrf
      remote: ncs
      repo-path: sdk-nrf
      revision: v3.4.1
      import:
        name-allowlist:
          - cjson
          - cmsis_6
          - cmock
          - hal_nordic
          - libmodem
          - mbedtls
          - mcuboot
          - nrfxlib
          - oberon-psa-crypto
          - segger
          - tf-psa-crypto
          - trusted-firmware-m
          - zcbor
          - zephyr
          - littlefs

    - name: memfault-firmware-sdk
      url: https://github.com/memfault/memfault-firmware-sdk
      path: modules/lib/memfault-firmware-sdk
      revision: 1.45.0

    - name: redteamobile-nusim
      url: https://github.com/redteamobile/ncs-nusim-app.git
      path: modules/lib/redteamobile-nusim
      revision: main
      groups:
        - nusim
```
