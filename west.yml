## west.yml
```yaml
# Copyright (c) 2025 Nordic Semiconductor
# SPDX-License-Identifier: LicenseRef-Nordic-5-Clause

manifest:
  self:
    import: submanifests

  remotes:
    - name: ncs
      url-base: https://github.com/nrfconnect

  projects:
    - name: nrf
      remote: ncs
      repo-path: sdk-nrf
      revision: d09e64cd1e3f224440d640a1aff05dde514e9e3b
      import:
        name-allowlist:
          - cjson
          - cmsis_6
          - cmock
          - hal_nordic
          - libmodem
          - mbedtls
          - mcuboot
          - memfault-firmware-sdk
          - nrfxlib
          - oberon-psa-crypto
          - segger
          - tf-psa-crypto
          - trusted-firmware-m
          - zcbor
          - zephyr
          - littlefs
```
